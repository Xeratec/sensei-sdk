## CMakeLists.txt
```
# SPDX-FileCopyrightText: 2026 ETH Zurich and University of Bologna
# SPDX-License-Identifier: Apache-2.0
#
# Authors:
# - Philip Wiese <wiesep@iis.ee.ethz.ch>

cmake_minimum_required(VERSION 3.20.0)

# The SDK system code needs the board devices i2ca and an ADC channel: emulators on native_sim.
list(APPEND EXTRA_DTC_OVERLAY_FILE ${CMAKE_CURRENT_LIST_DIR}/../common/sensei_sim.overlay)

find_package(Zephyr REQUIRED HINTS $ENV{ZEPHYR_BASE})
project(sensei_secure_test)

# The tests are those of the host build (lib/sensei_secure/tests, same file and vectors), here with the PSA backend.
set(SECURE_TESTS ${CMAKE_CURRENT_LIST_DIR}/../../../lib/sensei_secure/tests)
target_sources(app PRIVATE src/main.c src/ratchet.c src/e2e.c src/commission.c)
target_include_directories(app PRIVATE ${SECURE_TESTS} ${SECURE_TESTS}/generated)
```

## prj.conf
```kconfig
# SPDX-FileCopyrightText: 2026 ETH Zurich and University of Bologna
# SPDX-License-Identifier: Apache-2.0

CONFIG_ZTEST=y
CONFIG_ZTEST_STACK_SIZE=16384
CONFIG_SENSEI=y
CONFIG_SENSEI_SECURE=y
CONFIG_MBEDTLS_ENABLE_HEAP=y
CONFIG_MBEDTLS_HEAP_SIZE=524288
CONFIG_MAIN_STACK_SIZE=16384
CONFIG_SENSEI_SECURE_RATCHET=y
# The tests of the key store open many sessions and do not close all of them (the OpenSSL host build does not mind): room
# for the key slots and their key material (the heap of Mbed TLS holds it)
CONFIG_MBEDTLS_PSA_KEY_SLOT_COUNT=4096
# Commissioning (SPAKE2+): the test of the Mbed TLS ECP backend against the RFC 9383 vectors (V9) and the others
CONFIG_SENSEI_SECURE_COMMISSION=y
CONFIG_SENSEI_SECURE_SPAKE2P_MBEDTLS_ECP=y
```

## src/main.c
```c
/*
 * SPDX-FileCopyrightText: 2026 ETH Zurich and University of Bologna
 * SPDX-License-Identifier: Apache-2.0
 *
 * Authors:
 * - Philip Wiese <wiesep@iis.ee.ethz.ch>
 */

/* sensei_secure with the Zephyr backend (SDK crypto library on PSA). The test functions and the vectors are those
 * of the host test with OpenSSL (lib/sensei_secure/tests): the file is included, CHECK is zassert, each test
 * function is one test case. The Python vectors must come out the same on both backends. */

#include <zephyr/ztest.h>

#define SENSEI_SECURE_TEST_CHECK_H /* use this CHECK instead of check.h */
#define CHECK(cond) zassert_true((cond), #cond)
#define CHECK_DONE() 0
#define main host_main                                           /* not used */
#define sensei_secure_crypto_openssl sensei_secure_crypto_zephyr /* in host_main only */

#include "test_secure.c"

#undef main
#undef sensei_secure_crypto_openssl

static void *setup(void) {
  C = sensei_secure_crypto_zephyr();
  zassert_not_null(C);
  return NULL;
}

ZTEST(sensei_secure, test_keys) { test_keys(); }
ZTEST(sensei_secure, test_vectors) { test_vectors(); }
ZTEST(sensei_secure, test_tamper) { test_tamper(); }
ZTEST(sensei_secure, test_errors) { test_errors(); }
ZTEST(sensei_secure, test_replay_window) { test_replay_window(); }
ZTEST(sensei_secure, test_counters) { test_counters(); }
ZTEST(sensei_secure, test_senders) { test_senders(); }
ZTEST(sensei_secure, test_sender_table) { test_sender_table(); }
ZTEST(sensei_secure, test_init) { test_init(); }
ZTEST(sensei_secure, test_is_sealed_markers) { test_is_sealed_markers(); }
ZTEST(sensei_secure, test_fresh_keys) { test_fresh_keys(); }
ZTEST(sensei_secure, test_generation_bits) { test_generation_bits(); }

ZTEST_SUITE(sensei_secure, NULL, setup, NULL, NULL, NULL);
```

## src/commission.c
```c
/*
 * SPDX-FileCopyrightText: 2026 ETH Zurich and University of Bologna
 * SPDX-License-Identifier: Apache-2.0
 *
 * Authors:
 * - Philip Wiese <wiesep@iis.ee.ethz.ch>
 */

/* The commissioning (sensei_commission.c: SPAKE2+, the kind 5 channel, the verifier record) with the Zephyr backend and
 * the Mbed TLS ECP point arithmetic (CONFIG_SENSEI_SECURE_SPAKE2P_MBEDTLS_ECP, native_sim only). The test functions are
 * those of the host test (lib/sensei_secure/tests/test_commission.c): the file is included, CHECK is zassert, each test
 * function is one test case. test_v9 is the RFC 9383 appendix C exchange on this backend. */

#include <zephyr/ztest.h>

#define SENSEI_SECURE_TEST_CHECK_H /* use this CHECK instead of check.h */
#define CHECK(cond) zassert_true((cond), #cond)
#define CHECK_DONE() 0
#define main host_main_commission                                /* not used */
#define sensei_secure_crypto_openssl sensei_secure_crypto_zephyr /* in host_main only */

#include "test_commission.c"

#undef main
#undef sensei_secure_crypto_openssl

static void *setup_commission(void) {
  C0 = sensei_secure_crypto_zephyr();
  zassert_not_null(C0);
  zassert_not_null(C0->spake2p_zv);
  return NULL;
}

ZTEST(sensei_commission, test_v9) { test_v9(); }
ZTEST(sensei_commission, test_points) { test_points(); }
ZTEST(sensei_commission, test_v10) { test_v10(); }
ZTEST(sensei_commission, test_v11) { test_v11(); }
ZTEST(sensei_commission, test_v12) { test_v12(); }
ZTEST(sensei_commission, test_v13) { test_v13(); }
ZTEST(sensei_commission, test_v14) { test_v14(); }
ZTEST(sensei_commission, test_v15a) { test_v15a(); }
ZTEST(sensei_commission, test_x5_channel) { test_x5_channel(); }
ZTEST(sensei_commission, test_v15b) { test_v15b(); }
ZTEST(sensei_commission, test_v15c) { test_v15c(); }
ZTEST(sensei_commission, test_v15d) { test_v15d(); }
ZTEST(sensei_commission, test_flow) { test_flow(); }
ZTEST(sensei_commission, test_begin_twice) { test_begin_twice(); }
ZTEST(sensei_commission, test_aborts) { test_aborts(); }
ZTEST(sensei_commission, test_tamper) { test_tamper(); }
ZTEST(sensei_commission, test_time) { test_time(); }
ZTEST(sensei_commission, test_counting) { test_counting(); }
ZTEST(sensei_commission, test_backend_faults) { test_backend_faults(); }
ZTEST(sensei_commission, test_garbage) { test_garbage(); }

ZTEST_SUITE(sensei_commission, NULL, setup_commission, NULL, NULL, NULL);
```

## src/e2e.c
```c
/*
 * SPDX-FileCopyrightText: 2026 ETH Zurich and University of Bologna
 * SPDX-License-Identifier: Apache-2.0
 *
 * Authors:
 * - Philip Wiese <wiesep@iis.ee.ethz.ch>
 */

/* The device key store (sensei_e2e.c: state machine of the mix, counter blocks, power-loss replay) with the Zephyr
 * backend. The test functions are those of the host test (lib/sensei_secure/tests/test_e2e.c): the file is included,
 * CHECK is zassert, each test function is one test case. */

#include <zephyr/ztest.h>

#define SENSEI_SECURE_TEST_CHECK_H /* use this CHECK instead of check.h */
#define CHECK(cond) zassert_true((cond), #cond)
#define CHECK_DONE() 0
#define main host_main_e2e                                       /* not used */
#define sensei_secure_crypto_openssl sensei_secure_crypto_zephyr /* in host_main only */

static int check_failures; /* zassert stops at the first failure; only the transcript loop reads this */

#include "test_e2e.c"

#undef main
#undef sensei_secure_crypto_openssl

static void *setup_e2e(void) {
  C = sensei_secure_crypto_zephyr();
  zassert_not_null(C);
  return NULL;
}

ZTEST(sensei_e2e, test_first_start) { test_first_start(); }
ZTEST(sensei_e2e, test_provision_and_traffic) { test_provision_and_traffic(); }
ZTEST(sensei_e2e, test_key_a_b_a) { test_key_a_b_a(); }
ZTEST(sensei_e2e, test_two_senders) { test_two_senders(); }
ZTEST(sensei_e2e, test_rx_store_failure) { test_rx_store_failure(); }
ZTEST(sensei_e2e, test_sender_table_full) { test_sender_table_full(); }
ZTEST(sensei_e2e, test_clear_senders) { test_clear_senders(); }
ZTEST(sensei_e2e, test_replay_after_clear) { test_replay_after_clear(); }
ZTEST(sensei_e2e, test_reset) { test_reset(); }
ZTEST(sensei_e2e, test_reset_refused_when_erase_fails) { test_reset_refused_when_erase_fails(); }
ZTEST(sensei_e2e, test_priv_valid) { test_priv_valid(); }
ZTEST(sensei_e2e, test_damaged_key) { test_damaged_key(); }
ZTEST(sensei_e2e, test_sealed_key_crypto_error) { test_sealed_key_crypto_error(); }
ZTEST(sensei_e2e, test_key_unreadable) { test_key_unreadable(); }
ZTEST(sensei_e2e, test_key_store_failure) { test_key_store_failure(); }
ZTEST(sensei_e2e, test_reset_then_provision_is_refused_while_dirty) {
  test_reset_then_provision_is_refused_while_dirty();
}
ZTEST(sensei_e2e, test_fs_full_mix) { test_fs_full_mix(); }
ZTEST(sensei_e2e, test_fs_answers) { test_fs_answers(); }
ZTEST(sensei_e2e, test_fs_failing_writes) { test_fs_failing_writes(); }
ZTEST(sensei_e2e, test_fs_blocks) { test_fs_blocks(); }
ZTEST(sensei_e2e, test_fs_epoch_time) { test_fs_epoch_time(); }
ZTEST(sensei_e2e, test_fs_triggers) { test_fs_triggers(); }
ZTEST(sensei_e2e, test_fs_mark_ahead) { test_fs_mark_ahead(); }
ZTEST(sensei_e2e, test_fs_reprovision) { test_fs_reprovision(); }
ZTEST(sensei_e2e, test_fs_damaged) { test_fs_damaged(); }
ZTEST(sensei_e2e, test_fs_transcript) { test_fs_transcript(); }
ZTEST(sensei_e2e, test_fs_power_loss) { test_fs_power_loss(); }

ZTEST_SUITE(sensei_e2e, NULL, setup_e2e, NULL, NULL, NULL);
```

## src/ratchet.c
```c
/*
 * SPDX-FileCopyrightText: 2026 ETH Zurich and University of Bologna
 * SPDX-License-Identifier: Apache-2.0
 *
 * Authors:
 * - Philip Wiese <wiesep@iis.ee.ethz.ch>
 */

/* The forward secrecy primitives with the Zephyr backend (X25519, HMAC and HKDF of the SDK crypto library on PSA). The
 * test functions and the vectors are those of the host test (lib/sensei_secure/tests/test_ratchet.c): the file is
 * included, CHECK is zassert, each test function is one test case. */

#include <zephyr/ztest.h>

#define SENSEI_SECURE_TEST_CHECK_H /* use this CHECK instead of check.h */
#define CHECK(cond) zassert_true((cond), #cond)
#define CHECK_DONE() 0
#define main host_main_ratchet                                   /* not used */
#define sensei_secure_crypto_openssl sensei_secure_crypto_zephyr /* in host_main only */

static int check_failures; /* zassert stops at the first failure; only the transcript loop reads this */

#include "test_ratchet.c"

#undef main
#undef sensei_secure_crypto_openssl

static void *setup(void) {
  C = sensei_secure_crypto_zephyr();
  zassert_not_null(C);
  return NULL;
}

ZTEST(sensei_ratchet, test_root0) { test_root0(); }
ZTEST(sensei_ratchet, test_x25519) { test_x25519(); }
ZTEST(sensei_ratchet, test_mix) { test_mix(); }
ZTEST(sensei_ratchet, test_chain) { test_chain(); }
ZTEST(sensei_ratchet, test_epoch_math) { test_epoch_math(); }
ZTEST(sensei_ratchet, test_envelopes) { test_envelopes(); }
ZTEST(sensei_ratchet, test_envelope_tamper) { test_envelope_tamper(); }
ZTEST(sensei_ratchet, test_keyring) { test_keyring(); }
ZTEST(sensei_ratchet, test_tx_jump_persists) { test_tx_jump_persists(); }
ZTEST(sensei_ratchet, test_tx_block) { test_tx_block(); }
ZTEST(sensei_ratchet, test_hook_contract) { test_hook_contract(); }
ZTEST(sensei_ratchet, test_kind_byte) { test_kind_byte(); }
ZTEST(sensei_ratchet, test_transcript) { test_transcript(); }
ZTEST(sensei_ratchet, test_property) { test_property(); }

ZTEST_SUITE(sensei_ratchet, NULL, setup, NULL, NULL, NULL);
```
