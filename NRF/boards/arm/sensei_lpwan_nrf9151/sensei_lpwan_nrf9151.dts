// Copyright (c) 2026 ETH Zurich and University of Bologna
// SPDX-License-Identifier: Apache-2.0

/dts-v1/;
#include <nordic/nrf9151_laca.dtsi>
#include "sensei_lpwan_nrf9151_common.dtsi"

/ {
	chosen {
		zephyr,sram = &sram0_s;
		zephyr,flash = &flash0;
		zephyr,code-partition = &slot0_partition;
		zephyr,sram-secure-partition = &sram0_s;
		zephyr,sram-non-secure-partition = &sram0_ns;
	};
};
