// SPDX-FileCopyrightText: 2026 ETH Zurich and University of Bologna
// SPDX-License-Identifier: Apache-2.0

/*
 * Hands the nRF21540 control pins to the network core. Disabled by default, see NRF/overlays/lpwan_fem_cpunet.overlay for the whole procedure and the pin conflicts.
 */

/ {
	gpio_fwd: nrf-gpio-forwarder {
		compatible = "nordic,nrf-gpio-forwarder";
		status = "disabled";

		nrf21540-gpio-if {
			gpios = <&gpio0 27 0>, /* TX_EN */
				<&gpio1 13 0>; /* RX_EN */
		};
	};
};
