// Copyright (c) 2026 ETH Zurich and University of Bologna
// SPDX-License-Identifier: Apache-2.0

/dts-v1/;
#include <nordic/nrf9151_ns_laca.dtsi>
#include "sensei_lpwan_nrf9151_nrf9151_common.dtsi"

/ {
	chosen {
		zephyr,flash = &flash0;
		zephyr,sram = &sram0_ns_app;
		zephyr,code-partition = &slot0_ns_partition;
	};
};

/* TF-M uses UART1 by default; the shield has no UART. */
&uart1 {
	status = "disabled";
};
