## NRF/dts/bindings/sensei/sensei,lpwan-link.yaml
```yaml
# Copyright (c) 2026 ETH Zurich and University of Bologna
# SPDX-License-Identifier: Apache-2.0
description: |
  Handshake lines between the nRF5340 (SPI master) and the nRF9151 (SPI slave) of the LPWAN shield.
  The same binding is used on both sides. On the nRF9151 all lines are local GPIOs. On the nRF5340
  only the event line is a local GPIO; busy, ack and spare are pins of the shield's I/O expander.

compatible: "sensei,lpwan-link"

include: base.yaml

properties:
  event-gpios:
    type: phandle-array
    required: true
    description: High while an asynchronous event is waiting (nRF9151 output).
  busy-gpios:
    type: phandle-array
    required: true
    description: High while the nRF9151 is not ready for a transfer (nRF9151 output).
  ack-gpios:
    type: phandle-array
    description: Strobe from the master, high while it runs a transfer (nRF9151 input).
  spare-gpios:
    type: phandle-array
    description: Spare line from the master to the nRF9151.
  power-gpios:
    type: phandle-array
    description: Shield power switch enable (nRF5340 side, expander).
  level-shifter-gpios:
    type: phandle-array
    description: Level shifter output enable (nRF5340 side, expander).
  bb-mode-gpios:
    type: phandle-array
    description: Shield buck-boost mode (nRF5340 side, expander).
  spi-gap-sel-gpios:
    type: phandle-array
    description: GAP9 isolation switch on the shared SPI_A bus (nRF5340 side).
```

## NRF/dts/bindings/sensei/sensei,lpwan-nrf9151.yaml
```yaml
# Copyright (c) 2026 ETH Zurich and University of Bologna
# SPDX-License-Identifier: Apache-2.0
description: nRF9151 of the SENSEI LPWAN shield, an SPI slave (SPIS) seen from the nRF5340.

compatible: "sensei,lpwan-nrf9151"

include: spi-device.yaml
```

## NRF/dts/bindings/sensor/ams,as7331.yaml
```yaml
# SPDX-FileCopyrightText: 2026 ETH Zurich and University of Bologna
# SPDX-License-Identifier: Apache-2.0
---
description: |
  ams OSRAM AS7331 UVA, UVB and UVC sensor on I2C (0x74), command mode (one measurement per start). The
  shield has no rail switch for it, only the I2C isolation switch (bus-switch-supply). Software power-down
  (PD bit) is the suspend state.

compatible: "ams,as7331"

include: [sensor-device.yaml, i2c-device.yaml, sensei-sensor-supply.yaml]

properties:
  gain:
    type: int
    default: 10
    description: |
      CREG1 GAIN value, 0 to 11. The gain is 2048 / 2^value, so 10 is 2x. The default keeps the
      16-bit result registers from saturating in direct sunlight.

  integration-time:
    type: int
    default: 11
    description: CREG1 TIME value, 0 to 14. The conversion takes 2^value ms, so 11 is 2048 ms.

  ready-gpios:
    type: phandle-array
    description: |
      READY output (open drain, on the sensor shield behind the expander). The driver configures it as an
      input and as7331_ready() reads it. The measurement result is read when the status register says so.
```

## NRF/dts/bindings/sensor/bosch,bme688.yaml
```yaml
# SPDX-FileCopyrightText: 2026 ETH Zurich and University of Bologna
# SPDX-License-Identifier: Apache-2.0
---
description: |
  Bosch BME688 temperature, humidity, pressure and gas sensor on I2C (0x76 or 0x77), driven with the
  Bosch BME68x SensorAPI in forced mode with one heater step. Not a Zephyr "bosch,bme680" node: that driver
  has fixed settings and blocks during a measurement. BSEC is not used.

compatible: "bosch,bme688"

include: [sensor-device.yaml, i2c-device.yaml]

properties:
  heater-temp-c:
    type: int
    default: 320
    description: Heater plate temperature in degC (200 to 400).

  heater-duration-ms:
    type: int
    default: 150
    description: Heater duration in ms (1 to 4032).

  oversampling-temperature:
    type: int
    default: 2
    enum: [0, 1, 2, 4, 8, 16]
    description: Temperature oversampling (0 skips the measurement).

  oversampling-pressure:
    type: int
    default: 4
    enum: [0, 1, 2, 4, 8, 16]
    description: Pressure oversampling (0 skips the measurement).

  oversampling-humidity:
    type: int
    default: 2
    enum: [0, 1, 2, 4, 8, 16]
    description: Humidity oversampling (0 skips the measurement).
```

## NRF/dts/bindings/sensor/sensei,bh1730.yaml
```yaml
# SPDX-FileCopyrightText: 2026 ETH Zurich and University of Bologna
# SPDX-License-Identifier: Apache-2.0
---
description: |
  ROHM BH1730FVC ambient light sensor on I2C (0x29), one-time measurement of both channels. Not Zephyr's
  "rohm,bh1730" driver: this one delivers the raw channels, splits start and fetch and uses the power-down
  state (POWER bit) between measurements.

compatible: "sensei,bh1730"

include: [sensor-device.yaml, i2c-device.yaml]

properties:
  gain:
    type: int
    default: 2
    enum: [0, 1, 2, 3]
    description: GAIN register value. 0 is x1, 1 x2, 2 x64 and 3 x128.

  itime:
    type: int
    default: 0xED
    description: |
      TIMING register value. The integration time is 2.7 ms * (256 - value) per channel; 0xED gives 51 ms.
```

## NRF/dts/bindings/sensor/sensei,scd41.yaml
```yaml
# SPDX-FileCopyrightText: 2026 ETH Zurich and University of Bologna
# SPDX-License-Identifier: Apache-2.0
---
description: |
  Sensirion SCD41 CO2, temperature and humidity sensor on I2C (0x62), driven in single-shot mode with the
  Sensirion SCD4x library. A node with this compatible is a different driver from Zephyr's
  "sensirion,scd41" one: it splits start and fetch, switches the rail and can power down. Only one
  instance is possible (the Sensirion library keeps the I2C address in a global).

compatible: "sensei,scd41"

include: [sensor-device.yaml, i2c-device.yaml, sensei-sensor-supply.yaml]
```

## NRF/dts/bindings/sensor/sensei-sensor-supply.yaml
```yaml
# SPDX-FileCopyrightText: 2026 ETH Zurich and University of Bologna
# SPDX-License-Identifier: Apache-2.0
---
description: |
  Power switches of a sensor on the SENSEI sensor shield. The driver enables them when the sensor is
  resumed (pm_device_runtime_get) and disables them when it is suspended (pm_device_runtime_put).

properties:
  vdd-supply:
    type: phandle
    description: |
      Regulator that powers the sensor (regulator-fixed with the enable GPIO of the rail switch).
      Enabled first. Put the power-up time of the sensor in its startup-delay-us.

  bus-switch-supply:
    type: phandle
    description: |
      Regulator that closes the I2C isolation switch between the sensor and its bus (regulator-fixed on a
      GPIO expander pin). Enabled after vdd-supply, disabled before it.
```

## NRF/dts/bindings/sensor/sensirion,sgp41.yaml
```yaml
# SPDX-FileCopyrightText: 2026 ETH Zurich and University of Bologna
# SPDX-License-Identifier: Apache-2.0
---
description: |
  Sensirion SGP41 VOC and NOx sensor on I2C (0x59). The driver delivers raw ticks (SRAW_VOC, SRAW_NOX) with
  the Sensirion SGP41 library; the VOC and NOx index come from lib/sensei_gas_index. Only one instance is
  possible (the Sensirion library keeps the I2C address in a global).

compatible: "sensirion,sgp41"

include: [sensor-device.yaml, i2c-device.yaml, sensei-sensor-supply.yaml]
```

## NRF/dts/bindings/sensor/st,ilps28qsw.yaml
```yaml
# SPDX-FileCopyrightText: 2026 ETH Zurich and University of Bologna
# SPDX-License-Identifier: Apache-2.0
---
description: |
  STMicroelectronics ILPS28QSW pressure and temperature sensor on I2C. Not covered by Zephyr 4.4
  (its register map differs from the ILPS22QS and LPS28DFW drivers). The driver in NRF/drivers/sensor
  works in one-shot mode: the sensor powers down by itself after every conversion.

compatible: "st,ilps28qsw"

include: [sensor-device.yaml, i2c-device.yaml]

properties:
  avg:
    type: int
    default: 16
    enum: [4, 8, 16, 32, 64, 128, 256, 512]
    description: Number of samples averaged per conversion.

  full-scale:
    type: int
    default: 1260
    enum: [1260, 4060]
    description: Full scale in hPa.
```

## NRF/system/Kconfig
```kconfig
# Copyright (c) 2025 ETH Zurich and University of Bologna
# SPDX-License-Identifier: Apache-2.0

menu "System"

menuconfig SENSEI_COMM
	bool "Enable the SENSEI Communication Subsystem"
	default n
	depends on SENSEI
	help
	  Enable the SENSEI Communication Subsystem.

menuconfig SENSEI_PWR
	bool "Enable the SENSEI Power Subsystem"
	default n
	depends on SENSEI
	select SENSEI_PWR_MATH
	help
	  Enable the SENSEI Power Subsystem.

config SENSEI_PMIC_ADC_EXTERNAL
	bool "The application does the ADC conversions of the PMIC AMUX"
	default n
	depends on SENSEI_PWR
	help
	  The application owns the SAADC (for example because it streams samples with it). The PMIC board support
	  (bsp/pmic_bsp.c) then does not use the Zephyr ADC API or an ADC device: it calls
	  pmic_bsp_adc_ext_read(), which the application must define (a missing definition is a link error).
	  The Zephyr ADC driver (CONFIG_ADC) is not needed and must not be on when the application uses the SAADC
	  interrupt itself. See NRF/system/pwr/README.md.

rsource "pwr/Kconfig"
rsource "crypto/Kconfig"
rsource "ota/Kconfig"
rsource "marker/Kconfig"
rsource "wdt/Kconfig"
rsource "diag/Kconfig"

endmenu
```

## NRF/system/comm/Kconfig
```kconfig
module = SENSEI_COMM
module-str = Communication Subsystem
source "subsys/logging/Kconfig.template.log_config"
```

## NRF/system/crypto/Kconfig
```kconfig
# Copyright (c) 2025 ETH Zurich and University of Bologna
# SPDX-License-Identifier: Apache-2.0

menuconfig SENSEI_CRYPTO
	bool "Enable the SENSEI Crypto Library"
	default n
	depends on SENSEI
	select PSA_CRYPTO
	select PSA_WANT_GENERATE_RANDOM
	select PSA_WANT_ALG_SHA_256
	help
	  Enable the SENSEI Crypto Library, a simplified layer over the PSA
	  Crypto API (AES-GCM, SHA-256, HMAC, HKDF, ECDH and ECDSA on P-256).
	  The application must size the mbed TLS heap (CONFIG_MBEDTLS_ENABLE_HEAP
	  and CONFIG_MBEDTLS_HEAP_SIZE) and the stack of the calling thread.

if SENSEI_CRYPTO

config SENSEI_CRYPTO_AEAD
	bool "AES-GCM authenticated encryption"
	default y
	select PSA_WANT_ALG_GCM
	select PSA_WANT_KEY_TYPE_AES
	help
	  AES-128/256-GCM encryption and decryption.

config SENSEI_CRYPTO_HMAC
	bool "HMAC-SHA256"
	default y
	select PSA_WANT_ALG_HMAC
	select PSA_WANT_KEY_TYPE_HMAC
	help
	  HMAC-SHA256 message authentication.

config SENSEI_CRYPTO_HKDF
	bool "HKDF-SHA256 key derivation"
	default y
	select SENSEI_CRYPTO_HMAC
	select PSA_WANT_ALG_HKDF
	help
	  HKDF-SHA256 (RFC 5869) key derivation.

config SENSEI_CRYPTO_ECDH
	bool "ECDH on P-256"
	default y
	select PSA_WANT_ALG_ECDH
	select PSA_WANT_ECC_SECP_R1_256
	select PSA_WANT_KEY_TYPE_ECC_KEY_PAIR_IMPORT
	select PSA_WANT_KEY_TYPE_ECC_KEY_PAIR_EXPORT
	select PSA_WANT_KEY_TYPE_ECC_KEY_PAIR_GENERATE
	select PSA_WANT_KEY_TYPE_ECC_PUBLIC_KEY
	help
	  ECDH key agreement on NIST P-256.

config SENSEI_CRYPTO_ECDSA
	bool "ECDSA on P-256"
	default y
	select PSA_WANT_ALG_ECDSA
	select PSA_WANT_ECC_SECP_R1_256
	select PSA_WANT_KEY_TYPE_ECC_KEY_PAIR_IMPORT
	select PSA_WANT_KEY_TYPE_ECC_KEY_PAIR_EXPORT
	select PSA_WANT_KEY_TYPE_ECC_KEY_PAIR_GENERATE
	select PSA_WANT_KEY_TYPE_ECC_PUBLIC_KEY
	help
	  ECDSA signatures with SHA-256 on NIST P-256.

module = SENSEI_CRYPTO
module-str = SENSEI Crypto Library
source "subsys/logging/Kconfig.template.log_config"

endif # SENSEI_CRYPTO
```

## NRF/system/diag/Kconfig
```kconfig
# SPDX-FileCopyrightText: 2026 ETH Zurich and University of Bologna
# SPDX-License-Identifier: Apache-2.0
#
# Authors:
# - Philip Wiese <wiesep@iis.ee.ethz.ch>

DT_CHOSEN_SENSEI_DIAG_DUMP := sensei,diag-dump

menuconfig SENSEI_DIAG
	bool "Field diagnostics: reset cause, boot counter, fatal error record in retained RAM"
	default n
	select SENSEI_DIAG_CODEC
	select HWINFO
	select REBOOT
	# The retained RAM and the retention areas (devicetree chosen sensei,diag-fault and sensei,diag-state, see
	# README.md). Without them the record lives in noinit RAM, which a warm reset usually keeps, but nothing
	# guarantees it. The fatal handler writes from an interrupt, so no mutex.
	imply RETAINED_MEM
	imply RETENTION
	imply RETAINED_MEM_MUTEX_FORCE_DISABLE
	imply RETENTION_MUTEX_FORCE_DISABLE
	help
	  At boot: the full reset cause (hwinfo) and a boot counter. On a fatal error: reason, PC, LR, thread, uptime
	  and the last job id of the application go into retained RAM; the next boot hands the record to the
	  application once (sensei_diag_take_fault()). See NRF/system/diag/README.md.

if SENSEI_DIAG

config SENSEI_DIAG_FATAL_HANDLER
	bool "Record fatal errors (defines k_sys_fatal_error_handler)"
	default y
	depends on !RESET_ON_FATAL_ERROR
	help
	  The module defines k_sys_fatal_error_handler(): it records the fault and then resets (or halts, see below),
	  as RESET_ON_FATAL_ERROR of NCS does. NCS defines the same function, so turn RESET_ON_FATAL_ERROR off. Say
	  n if the application has its own handler and calls sensei_diag_capture() from it.

config SENSEI_DIAG_RESET_ON_FATAL
	bool "Reset after a fatal error"
	default y
	depends on SENSEI_DIAG_FATAL_HANDLER
	help
	  Reset the chip after the record is written (a trial image then reverts). Without it the handler halts, as
	  the Zephyr default does.

config SENSEI_DIAG_COREDUMP
	bool "Keep a small coredump of the faulting thread in retained RAM"
	depends on $(dt_chosen_enabled,$(DT_CHOSEN_SENSEI_DIAG_DUMP))
	depends on ARCH_SUPPORTS_COREDUMP
	select DEBUG_COREDUMP
	help
	  Registers the Zephyr coredump (backend "other") with the retention area of the devicetree chosen
	  sensei,diag-dump: the registers and the top of the stack of the faulting thread, as many bytes as fit (the
	  rest is dropped). Also set DEBUG_COREDUMP_BACKEND_OTHER=y and DEBUG_COREDUMP_MEMORY_DUMP_MIN=y (Kconfig
	  cannot select choice symbols), and DEBUG_COREDUMP_THREAD_STACK_TOP_LIMIT_FOR_CURRENT to the stack bytes you
	  want kept (about 700).
	  Costs about 2 kB of flash and the retention area in RAM. The dump has the format of the Zephyr coredump;
	  see README.md for how to read it.

module = SENSEI_DIAG
module-str = SENSEI diagnostics
source "subsys/logging/Kconfig.template.log_config"

endif # SENSEI_DIAG
```

## NRF/system/marker/Kconfig
```kconfig
# Copyright (c) 2026 ETH Zurich and University of Bologna
# SPDX-License-Identifier: Apache-2.0

config SENSEI_MARKER
	bool "Energy marker GPIOs"
	depends on SENSEI
	depends on GPIO
	help
	  Two GPIO outputs for the digital inputs of a power analyzer (sensei_marker.h). Needs the devicetree
	  aliases marker0 and marker1.
```
