## lib/sensei_secure/zephyr/Kconfig
```kconfig
# SPDX-FileCopyrightText: 2026 ETH Zurich and University of Bologna
# SPDX-License-Identifier: Apache-2.0
#
# Authors:
# - Philip Wiese <wiesep@iis.ee.ethz.ch>

config SENSEI_SECURE
	bool "SENSEI end-to-end envelope (ECDH P-256, HKDF, AES-128-GCM)"
	depends on SENSEI
	select SENSEI_CRYPTO
	select SENSEI_CRYPTO_AEAD
	select SENSEI_CRYPTO_ECDH
	select SENSEI_CRYPTO_HKDF
	help
	  Envelope library on the SENSEI SDK crypto library (lib/sensei_secure/README.md).

config SENSEI_SECURE_RATCHET
	bool "Forward secrecy: root key, mix and uplink chain (X25519, HMAC-SHA256)"
	depends on SENSEI_SECURE
	select SENSEI_CRYPTO_HMAC
	select SENSEI_CRYPTO_X25519
	help
	  The X25519 and HMAC functions of the cipher backend, which the mix needs. Off by default: an application that
	  runs the mix (the node: SENSEI_E2E_REKEY) turns it on. The envelope itself reads generation 1 and later (the ratchet
	  bits of the kind byte) with or without this option, but needs a keyring for it (struct sensei_secure_keyring). Without
	  it sensei_e2e never asks for a mix and stays in generation 0 (sensei_ratchet_available() is false); a stored
	  state of generation 1 or later cannot be used then and the device refuses to talk until it is provisioned again.

config SENSEI_SECURE_REKEY_STALE_EPOCHS
	int "Epochs after which an unanswered mix request is replaced"
	default 32768
	range 64 131072
	depends on SENSEI_SECURE_RATCHET
	help
	  A pending request that is older than this many epochs of sending (64 messages each, counted over all sealed
	  traffic, including kind 3 over BLE and USB) is replaced by a new one, and an answer to it is refused with
	  -ETIMEDOUT. The answer walks the uplink chain from the request to the current epoch: 32768 epochs take about
	  2 to 5 s on the crypto work queue of the nRF5340 (one HMAC-SHA256 with a PSA key import and destroy per epoch,
	  about 60 to 150 us each; an estimate: untested on hardware). While it runs the application work queue waits for
	  the crypto queue (sealed replies, the uplink submit, streaming seals block, and a host request can time out once),
	  and the node's health check (STUCK_MS 30 s in the node's scheduler) stops feeding the watchdog if the work queue
	  is late by more than that. The range stops at 131072 epochs (8 to 20 s by the estimate, below the 30 s). A node that seals more than this x 64 messages between a request and its answer does
	  not mix until the traffic drops (the collector alert for a node that never mixes shows it).

config SENSEI_SECURE_COMMISSION
	bool "Commissioning with a setup code (SPAKE2+, RFC 9383)"
	depends on SENSEI_SECURE
	select SENSEI_CRYPTO_HMAC
	select SENSEI_CRYPTO_HKDF
	help
	  src/sensei_commission.c: the verifier (node) and prover (commissioner) of the SPAKE2+ exchange, the kind 5
	  channel and the verifier record (sensei_commission.h). The cipher backend gets sha256, scalar_reduce and the
	  spake2p_* functions of the choice below. With SENSEI_SECURE_SETTINGS the verifier record (e2e_cmv) and the
	  attempt counters (e2e_cmf) are stored too (sensei_commission_settings.h). Flash: see lib/sensei_secure/README.md.

if SENSEI_SECURE_COMMISSION

choice SENSEI_SECURE_SPAKE2P_BACKEND
	prompt "Point arithmetic of SPAKE2+"
	help
	  Where the P-256 point operations of the exchange come from.

config SENSEI_SECURE_SPAKE2P_OCRYPTO
	bool "ocrypto of nrf_oberon (constant time)"
	depends on PSA_CRYPTO_DRIVER_OBERON
	help
	  ocrypto_spake2p_p256.h, in the library that nRF Security links for the Oberon PSA driver. For nRF boards.
	  Constant time in the secret scalars, no allocation. It does not exist on native_sim: use the MBEDTLS_ECP choice
	  there. Checked against the vectors on a Cortex-M33 in QEMU (NRF/tests/spake2p_ocrypto).

config SENSEI_SECURE_SPAKE2P_MBEDTLS_ECP
	bool "Mbed TLS ECP (native_sim and BabbleSim, tests only)"
	depends on ARCH_POSIX
	help
	  For simulators and tests. Uses the private ECP functions of Mbed TLS (mbedtls_ecp_muladd). It is not constant time
	  and it allocates. A real board cannot select it (the option needs the POSIX architecture), and a node image must
	  not use it.

endchoice

config SENSEI_SECURE_COMMISSION_PLAIN_VERIFIER
	bool "Keep the verifier record in plain flash when sealing is off (simulators)"
	default y
	depends on ARCH_POSIX && SENSEI_SECURE_SETTINGS && !SENSEI_SECURE_SETTINGS_SEAL
	help
	  Without CONFIG_SENSEI_SECURE_SETTINGS_SEAL the record e2e_cmv would be stored unsealed, and anyone who reads the
	  flash could guess the setup code offline. Only the POSIX simulators can have it (the option depends on
	  ARCH_POSIX); on a board the store function refuses (-ENOTSUP) without sealing, so a device that keeps verifiers
	  must seal (HUK).

endif # SENSEI_SECURE_COMMISSION

config SENSEI_SECURE_SETTINGS
	bool "Keep the end-to-end keys and counters in the settings subsystem"
	depends on SENSEI_SECURE
	select SETTINGS
	help
	  Storage backend of sensei_e2e (sensei_e2e_settings.h): key pair, collector key, counters.

config SENSEI_SECURE_SETTINGS_PREFIX
	string "Settings key prefix"
	default "sensei_comm"
	depends on SENSEI_SECURE_SETTINGS
	help
	  The keys are <prefix>/e2e_priv (e2e_privx when sealed), e2e_bpub, e2e_tx, e2e_rxs and e2e_rxf. The default is the prefix
	  of the SENSEI IEQ node: a node that updates keeps its keys. Changing it makes stored keys
	  unreachable (a new key pair is made, the collector has to be provisioned again).

config SENSEI_SECURE_SETTINGS_SEAL
	bool "Seal the secret records of the key store (AES-128-GCM)"
	depends on SENSEI_SECURE_SETTINGS
	help
	  The private key is stored as e2e_privx, a sealed record (sensei_e2e_seal.h: version, nonce, AES-128-GCM
	  ciphertext, tag), not as plain e2e_priv. A plain e2e_priv of an earlier version is migrated at the first
	  start: sealed, read back and checked. The plain record stays until the image is confirmed (the OTA module does it
	  for the application, see below; otherwise the application calls sensei_e2e_settings_confirm() after it has
	  confirmed the image (a trial image that MCUboot reverts finds its
	  key)); a plain record that is not a valid key is not sealed, the key store replaces it. The key comes from the function
	  sensei_e2e_settings_seal_key() (sensei_e2e_settings.h): one of the providers below, or the application's
	  own. If the key is not available, or a sealed record does not open, the key store does not start
	  (sensei_e2e_init() fails) and no new key pair is made over the old one. The ratchet state e2e_rat is sealed
	  the same way (with the key id of its key as context).

config SENSEI_SECURE_SETTINGS_CONFIRM_ON_OTA
	bool "Delete the plain key record when the OTA module confirms the image"
	default y
	depends on SENSEI_SECURE_SETTINGS_SEAL && SENSEI_OTA
	help
	  Registers sensei_e2e_settings_confirm() with sensei_ota_on_confirmed() at the first sensei_e2e_settings_load():
	  the plain e2e_priv that the migration kept is deleted when the running image is confirmed (by the node, by an SMP
	  confirm of the host, or at the start of an image that is confirmed already; the OTA module must be started with
	  sensei_ota_init()). A trial image that MCUboot reverts finds its key.

config SENSEI_SECURE_SETTINGS_CONFIRM_STACK_SIZE
	int "Stack of the work queue that deletes the plain key record at the confirmation"
	default 2048
	depends on SENSEI_SECURE_SETTINGS_CONFIRM_ON_OTA
	help
	  The delete runs on a work queue of its own (one thread, started at the first sensei_e2e_settings_load()), not on
	  the system work queue: a delete can wait for a garbage collection of the settings storage.

config SENSEI_SECURE_SETTINGS_CONFIRM_AFTER_LOAD
	bool "Delete the plain key record right after the load (no bootloader that reverts)"
	default y if !BOOTLOADER_MCUBOOT
	depends on SENSEI_SECURE_SETTINGS_SEAL
	help
	  Without MCUboot no old image can come back, so there is nothing to wait for. With MCUboot and without
	  SENSEI_OTA the application calls sensei_e2e_settings_confirm() after it has confirmed the image.

if SENSEI_SECURE_SETTINGS_SEAL

config SENSEI_SECURE_SETTINGS_SEAL_HUK
	bool "Key from the hardware unique key (CryptoCell-312 and KMU of the nRF5340)"
	depends on HAS_HW_NRF_CC312 && HW_UNIQUE_KEY_SUPPORTED && NRF_CC3XX_PLATFORM && !BUILD_WITH_TFM
	depends on !SENSEI_SECURE_SETTINGS_SEAL_TEST_KEY
	select HW_UNIQUE_KEY
	select HW_UNIQUE_KEY_RANDOM
	select MPU_ALLOW_FLASH_WRITE
	help
	  zephyr/sensei_e2e_huk.c: at the first use a random hardware unique key is written to the KMU (once, until
	  the chip is erased; the CPU cannot read it), and the sealing key is derived from it with the label
	  "SENSEI-E2E-AT-REST-v1". A flash image copied to another chip does not open, and stale settings pages
	  are unreadable without code execution on the chip. The debug port must still be locked (APPROTECT).
	  Needs NRF_CC3XX_PLATFORM (the application enables it; the CryptoCell also provides the random numbers).

config SENSEI_SECURE_SETTINGS_SEAL_TEST_KEY
	bool "Fixed key for tests (native_sim)"
	depends on ARCH_POSIX
	help
	  zephyr/sensei_e2e_testkey.c: a fixed key that a test can change or make fail. Never for a product: the
	  key is in the image.

endif # SENSEI_SECURE_SETTINGS_SEAL
```

## lib/sensei_sensor_math/zephyr/Kconfig
```kconfig
# SPDX-FileCopyrightText: 2026 ETH Zurich and University of Bologna
# SPDX-License-Identifier: Apache-2.0
#
# Authors:
# - Philip Wiese <wiesep@iis.ee.ethz.ch>

config SENSEI_SENSOR_MATH
	bool "SENSEI sensor math (unit conversions of the sensor shield drivers)"
	help
	  Conversions and timings of lib/sensei_sensor_math. The shield drivers in NRF/drivers/sensor select it.
```

## lib/sensei_timesync/zephyr/Kconfig
```kconfig
# SPDX-FileCopyrightText: 2026 ETH Zurich and University of Bologna
# SPDX-License-Identifier: Apache-2.0
#
# Authors:
# - Philip Wiese <wiesep@iis.ee.ethz.ch>

menuconfig SENSEI_TIMESYNC
	bool "Precise time synchronization over BLE connection anchor points"
	depends on SOC_COMPATIBLE_NRF5340_CPUAPP && BT
	select NRFX_GPPI
	select GPIO
	select MBOX
	select BT_HCI_VS_EVT_USER
	select ENTROPY_GENERATOR
	help
	  Mirror of the Bluetooth controller clock on the application core (RTC + TIMER), a global time
	  derived from the connection anchor points, hardware timestamping of pin edges and a timed
	  output (PPS). The network core image needs CONFIG_BT_CTLR_SDC_CONN_ANCHOR_POINT_REPORT=y,
	  CONFIG_MPSL_TRIGGER_IPC_TASK_ON_RTC_START=y and
	  CONFIG_MPSL_TRIGGER_IPC_TASK_ON_RTC_START_CHANNEL=<SENSEI_TIMESYNC_IPC_CHANNEL>.

if SENSEI_TIMESYNC

config SENSEI_TIMESYNC_MASTER
	bool "Master: send time samples to followers (BLE central)"
	depends on BT_CENTRAL
	select BT_GATT_CLIENT
	help
	  The global time is the local time of this node.

config SENSEI_TIMESYNC_FOLLOWER
	bool "Follower: follow a master (BLE peripheral)"
	depends on BT_PERIPHERAL
	help
	  Registers the time sync GATT service. With both roles enabled, the follower state wins once
	  a master has been found.

config SENSEI_TIMESYNC_RTC
	int "RTC instance of the controller clock mirror"
	range 0 1
	default 0
	help
	  Zephyr uses RTC1 as system timer on the nRF5340 application core, so the default is RTC0.
	  CC0: PPS compare. CC1: software time capture. CC2, CC3: edge capture channels.

config SENSEI_TIMESYNC_TIMER
	int "TIMER instance for the sub-tick part"
	range 0 2
	default 2
	help
	  Cleared on every RTC tick. Neither Zephyr nor NCS enable a TIMER on the application core by
	  default; TIMER2 leaves TIMER0 and TIMER1 to the samples and libraries that use them
	  (Nordic samples: TIMER0, nrf_audio: TIMER1). CC0: PPS compare. CC1: software time capture.
	  CC2, CC3: edge capture channels.

config SENSEI_TIMESYNC_EGU
	int "EGU instance for software capture, the IPC trigger and the PPS re-arm"
	range 0 5
	default 0
	help
	  Channel 0: software capture trigger. Channel 1: PPS edge done. Channel 2: IPC trigger seen.

config SENSEI_TIMESYNC_IPC_CHANNEL
	int "IPC channel the network core triggers when its RTC starts"
	range 0 15
	default 4
	help
	  Must be CONFIG_MPSL_TRIGGER_IPC_TASK_ON_RTC_START_CHANNEL of the network core image.
	  Channels 0 and 1 are used by the HCI IPC link, 7 and 8 by the synchronized RTC (logging).

config SENSEI_TIMESYNC_TIMER_16MHZ
	bool "TIMER at 16 MHz (62.5 ns resolution), else 1 MHz (1 us)"
	default y

config SENSEI_TIMESYNC_HFXO
	bool "Request the HFXO while the module runs"
	default y
	help
	  The TIMER counts the sub-tick part (up to 30.5 us). Without the HFXO it runs from the
	  internal RC oscillator (a few % off, up to about 1 us error). Costs a few hundred uA
	  of supply current as the HFXO never stops. The guard against a stale TIMER value at an
	  RTC tick (counts of a full tick or more are taken as 0) is only valid with the crystal;
	  without it counts are limited to the tick length instead.

config SENSEI_TIMESYNC_SAMPLE_PERIOD_MS
	int "Master: period of the time samples sent to each follower (ms)"
	range 20 60000
	default 250
	help
	  More samples per averaging period also average the master side anchor jitter.

config SENSEI_TIMESYNC_PAIR_PERIOD_MS
	int "Follower: averaging period of anchor pairs per model point (ms)"
	range 100 60000
	default 1000
	help
	  All pairs of a period are averaged into one point for the clock model.

config SENSEI_TIMESYNC_WINDOW
	int "Follower: points in the clock model fit"
	range 2 32
	default 16

config SENSEI_TIMESYNC_MIN_POINTS
	int "Follower: points needed before the model is valid"
	range 1 32
	default 4

config SENSEI_TIMESYNC_OUTLIER_NS
	int "Follower: pair or point farther than this from the model prediction is an outlier (ns)"
	range 1000 100000000
	default 50000

config SENSEI_TIMESYNC_HOLDOVER_MS
	int "Follower: no sample for this long moves the state to HOLDOVER (ms)"
	range 500 3600000
	default 5000

config SENSEI_TIMESYNC_MAX_FOLLOWERS
	int "Master: maximum number of followers"
	depends on SENSEI_TIMESYNC_MASTER
	range 1 20
	default 4

config SENSEI_TIMESYNC_PPS_GUARD_COUNTS
	int "PPS: TIMER counts kept free before the end of an RTC tick"
	range 1 64
	default 1
	help
	  The PPS compare value of the TIMER must be reached before the next RTC tick clears the TIMER. Edges whose
	  position in the tick is closer than this to the tick end are moved to the nearer allowed position (error up
	  to half of this many counts, 62.5 ns each at 16 MHz). BabbleSim has a time resolution of 1 us and needs 32.

config SENSEI_TIMESYNC_CAPTURE_CHANNELS
	int "Number of hardware edge capture channels"
	range 0 2
	default 1

config SENSEI_TIMESYNC_FOLLOWER_BIAS_NS
	int "Constant added to follower global times (ns)"
	default 0
	help
	  Calibration of a constant master/follower anchor point offset.

module = SENSEI_TIMESYNC
module-str = SENSEI time synchronization
source "subsys/logging/Kconfig.template.log_config"

endif # SENSEI_TIMESYNC
```
