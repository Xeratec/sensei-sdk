## lib/sensei_lpwan/zephyr/Kconfig
```kconfig
# SPDX-FileCopyrightText: 2026 ETH Zurich and University of Bologna
# SPDX-License-Identifier: Apache-2.0
#
# Authors:
# - Philip Wiese <wiesep@iis.ee.ethz.ch>

config SENSEI_LPWAN_PROTO
	bool "LPWAN shield link protocol (state machine, master and slave cores, timers)"
	select SENSEI_LINK
	help
	  The protocol of the SPI link between the nRF5340 and the nRF9151 of the LPWAN shield: frames,
	  the shared state machine and the 3GPP timer coding. Selected by the nRF5340 client
	  (SENSEI_LPWAN) and used by the nRF9151 app (NRF/apps/lpwan_shield).

config SENSEI_LPWAN_SIM_HOST
	bool
	depends on BOARD_NATIVE_SIM || BOARD_NRF5340BSIM_NRF5340_CPUAPP
	help
	  Host sockets and files for the simulated shield link (lpwan_sim_host.c in the native simulator runner). Selected by
	  SENSEI_LPWAN_SIM and by the simulated shield app.

menuconfig SENSEI_LPWAN
	bool "LPWAN shield client (LoRaWAN, LTE-M, NB-IoT over the nRF9151)"
	select SENSEI_LPWAN_PROTO
	select SENSEI_BUSARB
	select GPIO
	select I2C
	select SPI
	select PM_DEVICE
	select POLL
	help
	  SPI master to the nRF9151 on the LPWAN shield. Needs the LPWAN_Shield_v1 shield in the build
	  (devicetree aliases lpwan-link and lpwan-spi). The shield's pins P0.31 (event line) and P0.27
	  (nRF21540 TX_EN) clash with energy markers on the same pins. See lib/sensei_lpwan/README.md and
	  NRF/apps/lpwan_shield/HARDWARE.md.

if SENSEI_LPWAN

config SENSEI_LPWAN_LORA
	bool "LoRaWAN"
	default y

config SENSEI_LPWAN_LTE
	bool "LTE-M and NB-IoT"
	default y

config SENSEI_LPWAN_POWER_GATING
	bool "Power the shield only when it is needed (LoRa and BLE scenarios)"
	default y
	help
	  Switch the shield's 3.3 V rail off after SENSEI_LPWAN_IDLE_S without traffic when the
	  radio is LoRa or BLE. With LTE the rail stays on so the modem keeps its registration
	  (PSM). A LoRaWAN session survives a power cycle: the LR1121 keeps it in its flash.

config SENSEI_LPWAN_IDLE_S
	int "Idle time before the shield is powered down or the modem put to sleep, s"
	default 10
	range 1 3600

config SENSEI_LPWAN_BOOT_TIMEOUT_MS
	int "Time for the nRF9151 to boot and report ready, ms"
	default 3000

config SENSEI_LPWAN_REQUEST_TIMEOUT_MS
	int "Time to wait for the response to a request, ms"
	default 500

config SENSEI_LPWAN_JOIN_TIMEOUT_S
	int "Time to wait for a LoRaWAN join, s"
	default 180

config SENSEI_LPWAN_LTE_CONNECT_TIMEOUT_S
	int "Time to wait for LTE registration, s"
	default 600

config SENSEI_LPWAN_TX_TIMEOUT_S
	int "Time to wait for a transmit result without an estimate from the nRF9151, s"
	default 60
	help
	  A LoRa send gets the time the nRF9151 expects (duty-cycle wait, transmissions with their repeats, receive
	  windows; at most 10 min) plus 20 s, if that is longer. If the LR1121 still holds the frame then, the client
	  waits once more. Keep this value 15 s or more above LPWAN_SHIELD_SEND_TIMEOUT_S.

config SENSEI_LPWAN_LTE_EVAL
	bool "Ask the shield for a connection evaluation before an LTE data uplink"
	default y
	depends on SENSEI_LPWAN_LTE
	help
	  sensei_lpwan_lte_link_check() asks for AT%CONEVAL (energy estimate, RSRP, coverage level) at most every
	  SENSEI_LPWAN_EVAL_VALID_S. The app decides what to do with a bad estimate. Off: the check always says OK.

config SENSEI_LPWAN_EVAL_VALID_S
	int "Time a connection evaluation stays valid, s"
	default 600
	range 10 86400
	depends on SENSEI_LPWAN_LTE_EVAL

config SENSEI_LPWAN_EVAL_RETRY_S
	int "Time before an evaluation that gave nothing is asked for again, s"
	default 300
	range 10 86400
	depends on SENSEI_LPWAN_LTE_EVAL
	help
	  Applies to a result that is not valid, a request that failed and an answer that did not come. A shield that
	  refuses the request as unsupported (an older shield) is not asked again for an hour.

config SENSEI_LPWAN_LINK_FAILURES
	int "Failed requests (or sends without result) in a row before the shield is power-cycled"
	default 3
	range 1 20
	help
	  The nRF9151 may hang or reset. A request that gets no answer counts as one failure; after this
	  many in a row the client cuts the shield power and starts it again at the next use. A LoRaWAN
	  session survives in the LR1121, LTE registers again.

config SENSEI_LPWAN_SIM
	bool "Simulated shield: a socket instead of SPI, the expander and the pins (native_sim, BabbleSim)"
	depends on BOARD_NATIVE_SIM || BOARD_NRF5340BSIM_NRF5340_CPUAPP
	select SENSEI_LPWAN_SIM_HOST
	help
	  The link to the nRF9151 is a TCP connection to the simulated shield app (NRF/apps/lpwan_shield built for
	  native_sim): `zephyr.exe -lpwan_shield=<host>:<port>`. Connecting is the power of the shield, closing the
	  connection cuts it. Without a target the simulated node has no shield, as a base board without the LPWAN
	  shield; on BabbleSim that is the only case (no target there). For tests without hardware. See
	  lib/sensei_lpwan/README.md.

config SENSEI_LPWAN_SIM_TARGET
	string "Where the simulated shield listens, host:port (the command line option -lpwan_shield wins)"
	default ""
	depends on SENSEI_LPWAN_SIM && BOARD_NATIVE_SIM
	help
	  For tests that cannot give a command line (Twister). A port that nobody listens on is a shield that never boots.
	  Not on BabbleSim: its time is simulated, a TCP peer runs in real time. A BabbleSim node has no shield.

config SENSEI_LPWAN_SPI_HZ
	int "SPI clock, Hz"
	default 4000000
	help
	  The TXB0108 level shifter on the shield is auto-direction and weak: stay at 4 MHz or below.

config SENSEI_LPWAN_BB_MODE_PFM
	bool "Shield buck-boost in power-save mode (default: forced PWM)"
	help
	  Power-save mode saves current at light load but adds ripple at the LTE and LoRa transmit
	  bursts. Untested on hardware.

config SENSEI_LPWAN_FEM
	bool "nRF21540 range extender on the shield is in use (BLE)"
	help
	  Off (the default): the client drives the extender's power-down line (expander P5) and MODE (P6) low at every
	  bring-up and power-off and leaves them so: a powered-down extender draws no current. On: nPD is high while the
	  shield is on. Only the pin side. The radio side (MPSL front-end support on the network core, see
	  NRF/overlays/lpwan_fem_cpunet.overlay) is not implemented. Untested on hardware.

config SENSEI_LPWAN_FEM_MODE_HIGH
	bool "nRF21540 MODE line (expander P6) high while the extender is in use"
	depends on SENSEI_LPWAN_FEM
	help
	  Which transmit gain setting that selects is in the nRF21540 data sheet. Untested on hardware.

config SENSEI_LPWAN_SHELL
	bool "Shell commands: sensei lpwan status|power|join|connect|disconnect|provision"
	depends on SHELL
	help
	  Needs a shell root command "sensei" (SHELL_SUBCMD_SET_CREATE(<name>, (sensei)) in the app).

config SENSEI_LPWAN_LTE_APN
	string "LTE access point name (empty: SIM default)"
	default ""

config SENSEI_LPWAN_EDRX_CYCLE_MS
	int "eDRX cycle requested when sensei_lpwan_config.lte_edrx is set, ms"
	default 81920

config SENSEI_LPWAN_EDRX_PTW_MS
	int "eDRX paging time window requested, ms"
	default 5120

config SENSEI_LPWAN_STACK_SIZE
	int "LPWAN client thread stack size"
	default 3072

config SENSEI_LPWAN_THREAD_PRIORITY
	int "LPWAN client thread priority (preemptible)"
	default 7

module = SENSEI_LPWAN
module-str = LPWAN client
source "subsys/logging/Kconfig.template.log_config"

endif # SENSEI_LPWAN
```

## lib/sensei_pwr_math/zephyr/Kconfig
```kconfig
# SPDX-FileCopyrightText: 2026 ETH Zurich and University of Bologna
# SPDX-License-Identifier: Apache-2.0
#
# Authors:
# - Philip Wiese <wiesep@iis.ee.ethz.ch>

config SENSEI_PWR_MATH
	bool "SENSEI power math (battery charge estimate, button press detection)"
	help
	  Pure logic of lib/sensei_pwr_math. The power module (SENSEI_PWR) selects it.
```
