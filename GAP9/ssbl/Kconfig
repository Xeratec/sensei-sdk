## GAP9/ssbl/test/app/Kconfig
```kconfig
# SPDX-FileCopyrightText: 2026 ETH Zurich and University of Bologna
# SPDX-License-Identifier: Apache-2.0
#
# Authors:
# - Philip Wiese <wiesep@iis.ee.ethz.ch>

source "$(GAP_SDK_HOME)/utils/kconfig/Kconfig"
```

## NRF/Kconfig
```kconfig
# Copyright (c) 2025 ETH Zurich and University of Bologna
# SPDX-License-Identifier: Apache-2.0

menu "SENSEI Configuration"

config SENSEI
	bool "Enable SENSEI SDK"
	default n
	help
	  Enable SENSEI SDK features.

rsource "drivers/Kconfig"
rsource "system/Kconfig"

# Portable libraries of lib/
rsource "../lib/sensei_link/zephyr/Kconfig"
rsource "../lib/sensei_busarb/zephyr/Kconfig"
rsource "../lib/sensei_gap9/zephyr/Kconfig"
rsource "../lib/sensei_lpwan/zephyr/Kconfig"
rsource "../lib/sensei_delta/zephyr/Kconfig"
rsource "../lib/sensei_secure/zephyr/Kconfig"
rsource "../lib/sensei_gas_index/zephyr/Kconfig"
rsource "../lib/sensei_sensor_math/zephyr/Kconfig"
rsource "../lib/sensei_pwr_math/zephyr/Kconfig"
rsource "../lib/sensei_diag/zephyr/Kconfig"
rsource "../lib/sensei_charge/zephyr/Kconfig"

endmenu
```

## NRF/boards/arm/sensei_lpwan_nrf9151/Kconfig.board
```kconfig
# Copyright (c) 2026 ETH Zurich and University of Bologna
# SPDX-License-Identifier: Apache-2.0

config BOARD_SENSEI_LPWAN_NRF9151
	bool "SENSEI LPWAN shield nRF9151 (secure)"
	depends on SOC_NRF9151_LACA

config BOARD_SENSEI_LPWAN_NRF9151_NS
	bool "SENSEI LPWAN shield nRF9151 (non-secure, TF-M)"
	depends on SOC_NRF9151_LACA
```

## NRF/boards/arm/sensei_lpwan_nrf9151/Kconfig.defconfig
```kconfig
# Copyright (c) 2026 ETH Zurich and University of Bologna
# SPDX-License-Identifier: Apache-2.0

if BOARD_SENSEI_LPWAN_NRF9151 || BOARD_SENSEI_LPWAN_NRF9151_NS

config BOARD
	default "sensei_lpwan_nrf9151"

# The secure image is linked into the code partition from the devicetree if MCUboot loads it.
DT_CHOSEN_Z_CODE_PARTITION := zephyr,code-partition

config FLASH_LOAD_SIZE
	default $(dt_chosen_reg_size_hex,$(DT_CHOSEN_Z_CODE_PARTITION))
	depends on BOARD_SENSEI_LPWAN_NRF9151 && TRUSTED_EXECUTION_SECURE

if BOARD_SENSEI_LPWAN_NRF9151_NS

config FLASH_LOAD_OFFSET
	default $(dt_chosen_reg_addr_hex,$(DT_CHOSEN_Z_CODE_PARTITION))

config FLASH_LOAD_SIZE
	default $(dt_chosen_reg_size_hex,$(DT_CHOSEN_Z_CODE_PARTITION))

endif # BOARD_SENSEI_LPWAN_NRF9151_NS

endif # BOARD_SENSEI_LPWAN_NRF9151 || BOARD_SENSEI_LPWAN_NRF9151_NS
```

## NRF/boards/arm/sensei_lpwan_nrf9151/sensei_lpwan_nrf9151_defconfig
```kconfig
# Copyright (c) 2026 ETH Zurich and University of Bologna
# SPDX-License-Identifier: Apache-2.0

CONFIG_SOC_SERIES_NRF91X=y
CONFIG_SOC_NRF9151_LACA=y
CONFIG_BOARD_SENSEI_LPWAN_NRF9151=y

CONFIG_ARM_MPU=y
CONFIG_HW_STACK_PROTECTION=y
CONFIG_GPIO=y
```

## NRF/boards/eth-zurich/nrf5340_senseiv1/Kconfig.nrf5340_senseiv1
```kconfig
# Copyright (c) 2025 ETH Zurich and University of Bologna
# SPDX-License-Identifier: Apache-2.0

config BOARD_NRF5340_SENSEIV1
	select SOC_NRF5340_CPUAPP_QKAA if BOARD_NRF5340_SENSEIV1_NRF5340_CPUAPP || \
		BOARD_NRF5340_SENSEIV1_NRF5340_CPUAPP_BOOTLOADER
	select SOC_NRF5340_CPUNET_QKAA if BOARD_NRF5340_SENSEIV1_NRF5340_CPUNET
```

## NRF/boards/eth-zurich/nrf5340_senseiv1/board.yml
```yaml
# Copyright (c) 2025 ETH Zurich and University of Bologna
# SPDX-License-Identifier: Apache-2.0
---
board:
  name: nrf5340_senseiv1
  full_name: SENSEI v1
  vendor: eth-zurich
  socs:
    - name: nrf5340
      variants:
        - name: bootloader
          cpucluster: cpuapp
```

## NRF/boards/eth-zurich/nrf5340_senseiv1/nrf5340_senseiv1_nrf5340_cpunet_defconfig
```kconfig
# Copyright (c) 2025 ETH Zurich and University of Bologna
# SPDX-License-Identifier: Apache-2.0

# Enable MPU
CONFIG_ARM_MPU=y

# Enable hardware stack protection
CONFIG_HW_STACK_PROTECTION=y

# Enable Drivers
CONFIG_GPIO=y
CONFIG_MBOX=y
CONFIG_MBOX_NRFX_IPC=y
CONFIG_SERIAL=y
```

## NRF/boards/eth-zurich/sensei_lpwan_nrf9151/Kconfig.defconfig
```kconfig
# Copyright (c) 2026 ETH Zurich and University of Bologna
# SPDX-License-Identifier: Apache-2.0

config HW_STACK_PROTECTION
	default ARCH_HAS_STACK_PROTECTION
```

## NRF/boards/eth-zurich/sensei_lpwan_nrf9151/board.yml
```yaml
# Copyright (c) 2026 ETH Zurich and University of Bologna
# SPDX-License-Identifier: Apache-2.0
---
board:
  name: sensei_lpwan_nrf9151
  full_name: SENSEI LPWAN shield nRF9151
  vendor: eth-zurich
  socs:
    - name: nrf9151
      variants:
        - name: ns
```

## NRF/boards/eth-zurich/sensei_lpwan_nrf9151/sensei_lpwan_nrf9151_nrf9151_defconfig
```kconfig
# Copyright (c) 2026 ETH Zurich and University of Bologna
# SPDX-License-Identifier: Apache-2.0

CONFIG_ARM_MPU=y
CONFIG_HW_STACK_PROTECTION=y
CONFIG_GPIO=y
```

## NRF/boards/shields/LPWAN_Shield_v1/Kconfig.shield
```kconfig
# Copyright (c) 2026 ETH Zurich and University of Bologna
# SPDX-License-Identifier: Apache-2.0

config SHIELD_LPWAN_SHIELD_V1
	def_bool $(shields_list_contains,LPWAN_Shield_v1)
```

## NRF/drivers/Kconfig
```kconfig
# Copyright (c) 2025 ETH Zurich and University of Bologna
# SPDX-License-Identifier: Apache-2.0

menu "Drivers"
rsource "gnss/Kconfig"
rsource "memory/Kconfig"
rsource "sensor/Kconfig"
endmenu
```

## NRF/drivers/gnss/Kconfig
```kconfig
# SPDX-FileCopyrightText: 2026 ETH Zurich and University of Bologna
# SPDX-License-Identifier: Apache-2.0

config GNSS_M10S
	bool "u-blox MAX-M10S GNSS receiver on I2C"
	default y
	depends on DT_HAS_U_BLOX_MAX_M10S_ENABLED
	select GNSS
	select I2C
	help
	  Driver for the u-blox MAX-M10S on I2C (DDC) with the UBX protocol. Delivers fixes and satellites
	  through the Zephyr GNSS API. Zephyr's own u-blox drivers are UART only.

if GNSS_M10S

config GNSS_M10S_RX_BUFFER_SIZE
	int "Largest UBX payload the driver accepts"
	default 512
	range 128 2048
	help
	  UBX-NAV-SAT needs 8 + 12 bytes per satellite. Longer messages are dropped.

config GNSS_M10S_MAX_SATELLITES
	int "Satellites kept for the satellites callback"
	default 40
	range 8 96
	depends on GNSS_SATELLITES

endif # GNSS_M10S
```

## NRF/drivers/memory/Kconfig
```kconfig
# SPDX-FileCopyrightText: 2026 ETH Zurich and University of Bologna
# SPDX-License-Identifier: Apache-2.0

config PSRAM_APS12804O
	bool "APS12804O QSPI PSRAM on the nRF5340 QSPI pins"
	default y
	depends on DT_HAS_APMEMORY_APS12804O_ENABLED
	depends on SOC_NRF5340_CPUAPP
	select NRFX_QSPI
	select GPIO
	help
	  16 MiB PSRAM of the SENSEI base board. Untested on hardware.

if PSRAM_APS12804O
module = PSRAM_APS12804O
module-str = APS12804O PSRAM
source "subsys/logging/Kconfig.template.log_config"
endif
```

## NRF/drivers/sensor/Kconfig
```kconfig
# SPDX-FileCopyrightText: 2026 ETH Zurich and University of Bologna
# SPDX-License-Identifier: Apache-2.0

config ILPS28QSW_SENSEI
	bool "ILPS28QSW pressure sensor"
	default y
	depends on DT_HAS_ST_ILPS28QSW_ENABLED
	depends on SENSOR
	select I2C
	help
	  Driver for the ILPS28QSW on I2C, built on the SDK register library (NRF/system/third_party/st).

config LIS2DUXS12_EXTRA
	bool "LIS2DUXS12 wake-up interrupt and deep power-down"
	default y
	depends on DT_HAS_ST_LIS2DUXS12_ENABLED
	depends on LIS2DUX12
	select SENSEI_SENSOR_MATH
	help
	  Helpers for what the Zephyr LIS2DUX12 driver lacks. They use the register library of the
	  Zephyr ST HAL (hal_st), which the Zephyr driver already selects.

config SENSEI_SENSIRION_HAL
	bool
	select I2C
	help
	  Sensirion common code (SCD4x repository) and its Zephyr I2C glue. Selected by the SCD41 and SGP41 drivers.

config SCD41_SENSEI
	bool "SCD41 CO2 sensor (single shot, power-gated)"
	depends on DT_HAS_SENSEI_SCD41_ENABLED
	depends on SENSOR
	depends on PM_DEVICE_RUNTIME
	select I2C
	select REGULATOR
	select SENSEI_SENSIRION_HAL
	select SENSEI_SENSOR_MATH
	help
	  Driver for the SCD41 on the Sensirion SCD4x library (node "sensei,scd41"). Zephyr's own SCD4x driver
	  (node "sensirion,scd41") cannot split a single shot into start and fetch and does not switch a rail.
	  Off by default: it needs CONFIG_PM_DEVICE_RUNTIME=y, which the application sets.

config SGP41_SENSEI
	bool "SGP41 VOC and NOx sensor (raw ticks, power-gated)"
	depends on DT_HAS_SENSIRION_SGP41_ENABLED
	depends on SENSOR
	depends on PM_DEVICE_RUNTIME
	select I2C
	select REGULATOR
	select SENSEI_SENSIRION_HAL
	select SENSEI_SENSOR_MATH
	help
	  Driver for the SGP41 on the Sensirion SGP41 library. Zephyr has only an SGP40 driver. The VOC and NOx
	  index come from lib/sensei_gas_index (CONFIG_SENSEI_GAS_INDEX).
	  Off by default: it needs CONFIG_PM_DEVICE_RUNTIME=y, which the application sets.

config SGP41_SENSEI_CONDITIONING_S
	int "Conditioning time of sensor_sample_fetch() in s"
	default 10
	range 0 10
	depends on SGP41_SENSEI
	help
	  The sensor needs 10 s of conditioning (10 commands, 1 s apart) after a cold start before the NOx raw
	  value is valid. With 0 only the VOC value is meaningful. The split API of the driver leaves the timing to
	  the caller.

config BME688_SENSEI
	bool "BME688 T/RH/p/gas sensor (Bosch API, forced mode)"
	default y
	depends on DT_HAS_BOSCH_BME688_ENABLED
	depends on SENSOR
	select I2C
	help
	  Driver for the BME688 on the Bosch BME68x SensorAPI (node "bosch,bme688"). Zephyr's bme680 driver has
	  fixed settings and blocks during a measurement. BSEC is not used.

config AS7331_SENSEI
	bool "AS7331 UV sensor (command mode, power-gated)"
	depends on DT_HAS_AMS_AS7331_ENABLED
	depends on SENSOR
	depends on PM_DEVICE_RUNTIME
	select I2C
	select REGULATOR
	select GPIO
	select SENSEI_SENSOR_MATH
	help
	  Driver for the AS7331 on the AMS register library. Results in uW/cm2. Zephyr has no AS7331 driver.
	  Off by default: it needs CONFIG_PM_DEVICE_RUNTIME=y, which the application sets.

config BH1730_SENSEI
	bool "BH1730FVC light sensor (one-time measurement, power-gated)"
	depends on DT_HAS_SENSEI_BH1730_ENABLED
	depends on SENSOR
	depends on PM_DEVICE_RUNTIME
	select I2C
	select SENSEI_SENSOR_MATH
	help
	  Driver for the BH1730FVC on the ROHM register library (node "sensei,bh1730"). Zephyr's "rohm,bh1730"
	  driver delivers lux only, blocks during a measurement and has no power-down.
	  Off by default: it needs CONFIG_PM_DEVICE_RUNTIME=y, which the application sets.
```

## NRF/dts/bindings/gnss/u-blox,max-m10s.yaml
```yaml
# SPDX-FileCopyrightText: 2026 ETH Zurich and University of Bologna
# SPDX-License-Identifier: Apache-2.0
---
description: |
  u-blox MAX-M10S GNSS module on I2C (DDC, address 0x42). UBX protocol only.

  The pins RESET_N, EXTINT and TIMEPULSE are optional. On the SENSEI sensor shield they sit on the
  PCA6416A expander. Never drive TIMEPULSE low while the module starts: the pin is shared with SAFEBOOT_N.

compatible: "u-blox,max-m10s"

include: i2c-device.yaml

properties:
  reset-gpios:
    type: phandle-array
    description: |
      RESET_N. Use GPIO_ACTIVE_LOW, so that "active" means reset asserted. Used by the reset call and
      as a wake-up fallback if there is no EXTINT pin.

  extint-gpios:
    type: phandle-array
    description: |
      EXTINT, used to wake the module from software standby (UBX-RXM-PMREQ). An edge on the pin wakes it.

  timepulse-gpios:
    type: phandle-array
    description: |
      TIMEPULSE (also SAFEBOOT_N). The driver configures it as an input and does not use it.
      On the sensor shield it is behind the expander, which has no interrupt line to the nRF5340.

  fix-rate:
    type: int
    default: 1000
    description: Fix interval in milliseconds at start-up. Can be changed with gnss_set_fix_rate().

  standby-at-boot:
    type: boolean
    description: |
      Send the module to software standby right after start-up and leave it there until the
      application wakes it (gnss_m10s_wake() or PM_DEVICE_ACTION_RESUME). Without this property the
      driver configures the module and starts delivering fixes at boot.

  polled:
    type: boolean
    description: |
      Poll UBX-NAV-PVT (and NAV-SAT) once per fix interval instead of letting the module output
      them periodically.

  poll-interval-ms:
    type: int
    default: 200
    description: |
      How often the driver reads the I2C stream in periodic mode. Keep it well below the fix interval.

  power-save:
    type: string
    default: "full"
    enum:
      - "full"
      - "psmoo"
      - "psmct"
    description: |
      Power save mode of the receiver: full power, ON/OFF operation (PSMOO) or cyclic tracking (PSMCT).

  power-save-period:
    type: int
    default: 10
    description: |
      Position update period in seconds for PSMOO and PSMCT (at least 5 s).
```

## NRF/dts/bindings/memory/apmemory,aps12804o.yaml
```yaml
# SPDX-FileCopyrightText: 2026 ETH Zurich and University of Bologna
# SPDX-License-Identifier: Apache-2.0
---
description: |
  AP Memory APS12804O 128 Mbit (16 MiB) QSPI PSRAM on the nRF5340 QSPI pins (P0.13 to P0.18).
  1.8 V, supplied through a load switch. The chip select goes through a mux (TS5A3153) that also
  reaches the board-to-board connector. The driver uses the nrfx QSPI driver directly, so the Zephyr
  QSPI NOR flash driver must stay disabled (keep &qspi disabled).

compatible: "apmemory,aps12804o"

include: base.yaml

properties:
  power-gpios:
    type: phandle-array
    required: true
    description: Load switch of the PSRAM supply (P1.14, high = on).

  cs-select-gpios:
    type: phandle-array
    required: true
    description: |
      Chip select mux input (P0.19). Low connects the QSPI chip select to the PSRAM, high to the
      board-to-board connector.
```

## NRF/dts/bindings/semtech/semtech,lr1121-modem.yaml
```yaml
# Copyright (c) 2026 ETH Zurich and University of Bologna
# SPDX-License-Identifier: Apache-2.0
description: Semtech LR1121 transceiver with the LoRa Basics Modem-E firmware, on SPI.

compatible: "semtech,lr1121-modem"

include: spi-device.yaml

properties:
  reset-gpios:
    type: phandle-array
    required: true
  busy-gpios:
    type: phandle-array
    required: true
  event-gpios:
    type: phandle-array
    required: true
    description: DIO9, rises when the modem has an event.
```
