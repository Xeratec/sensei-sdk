## NRF/tests/ubx/testcase.yaml
```yaml
# SPDX-FileCopyrightText: 2026 ETH Zurich and University of Bologna
# SPDX-License-Identifier: Apache-2.0
---
tests:
  sensei.drivers.gnss.ubx:
    platform_allow:
      - native_sim
      - native_sim/native/64
      - qemu_cortex_m3
    tags: sensei gnss
```

## NRF/tests/wdt/testcase.yaml
```yaml
# SPDX-FileCopyrightText: 2026 ETH Zurich and University of Bologna
# SPDX-License-Identifier: Apache-2.0
---
tests:
  sensei.wdt:
    platform_allow:
      - native_sim/native/64
    tags: sensei wdt
```

## lib/sensei_busarb/zephyr/Kconfig
```kconfig
# SPDX-FileCopyrightText: 2026 ETH Zurich and University of Bologna
# SPDX-License-Identifier: Apache-2.0
#
# Authors:
# - Philip Wiese <wiesep@iis.ee.ethz.ch>

config SENSEI_BUSARB
	bool "Arbitration of the shared SPI_A bus and LTE current peaks"
	help
	  One owner at a time for SPI_A (P0.08 to P0.11, shared by GAP9 and the LPWAN shield) and a rule
	  that GAP9 does not run during an LTE transmission. Selected by SENSEI_GAP9 and SENSEI_LPWAN.
```

## lib/sensei_charge/zephyr/Kconfig
```kconfig
# SPDX-FileCopyrightText: 2026 ETH Zurich and University of Bologna
# SPDX-License-Identifier: Apache-2.0
#
# Authors:
# - Philip Wiese <wiesep@iis.ee.ethz.ch>

config SENSEI_CHARGE
	bool "SENSEI software charge counter (states, events, self-discharge, record)"
	help
	  Pure logic of lib/sensei_charge. The power module option SENSEI_PWR_CHARGE selects it.
```

## lib/sensei_delta/zephyr/Kconfig
```kconfig
# SPDX-FileCopyrightText: 2026 ETH Zurich and University of Bologna
# SPDX-License-Identifier: Apache-2.0
#
# Authors:
# - Philip Wiese <wiesep@iis.ee.ethz.ch>

config SENSEI_DELTA
	bool "SENSEI delta coder engine (DPCM + rANS/Huffman)"
	help
	  Lossy delta coder for windows of seven sensor channels. The application provides the
	  tables (struct sensei_delta_tables). See lib/sensei_delta/README.md.

if SENSEI_DELTA

config SENSEI_DELTA_RANS
	bool "rANS entropy coder"
	default y

config SENSEI_DELTA_HUFFMAN
	bool "Huffman entropy coder"
	default y

config SENSEI_DELTA_PROFILE
	bool "Cycle profiling hooks (DWT)"
	help
	  Defines SENSEI_DELTA_PORT_NRF5340: sensei_delta_prof_cycles[] collects the cycles of
	  the DPCM and entropy-coder parts of the encoder.

endif # SENSEI_DELTA
```

## lib/sensei_diag/zephyr/Kconfig
```kconfig
# SPDX-FileCopyrightText: 2026 ETH Zurich and University of Bologna
# SPDX-License-Identifier: Apache-2.0
#
# Authors:
# - Philip Wiese <wiesep@iis.ee.ethz.ch>

config SENSEI_DIAG_CODEC
	bool "SENSEI diagnostics codec (reset cause bits, fault record, boot state)"
	help
	  Pure logic of lib/sensei_diag. The diagnostics module (SENSEI_DIAG) selects it.
```

## lib/sensei_gap9/zephyr/Kconfig
```kconfig
# SPDX-FileCopyrightText: 2026 ETH Zurich and University of Bologna
# SPDX-License-Identifier: Apache-2.0
#
# Authors:
# - Philip Wiese <wiesep@iis.ee.ethz.ch>

menu "SENSEI GAP9"

config SENSEI_GAP9
	bool "GAP9 link (power, boot, SPI jobs)"
	select SENSEI_LINK
	select SENSEI_BUSARB
	select GPIO
	select SPI
	select SPI_SLAVE
	select SPI_ASYNC
	select PINCTRL
	help
	  Link to the GAP9 of the SENSEI base board: powers it only while jobs are pending, boots it,
	  exchanges jobs and results over SPI (GAP9 is the master), and hands the camera I2C bus over.
	  Needs CONFIG_SENSEI_PWR for the GAP9 power rail (gap9_pwr()). The app brings the job format
	  (struct g9_codec). The devicetree needs
	  lib/sensei_gap9/zephyr/gap9_link.overlay. Protocol: lib/sensei_gap9/PROTOCOL.md.

config SENSEI_GAP9_QUEUE_DEPTH
	int "Jobs queued in the link (each costs two job structs of the app in RAM)"
	default 2
	range 1 8
	depends on SENSEI_GAP9

config SENSEI_GAP9_STAGE_DEPTH
	int "Jobs that can wait outside the queue (each costs one job struct of the app in RAM)"
	default 2
	range 1 4
	depends on SENSEI_GAP9
	help
	  gap9_link_submit() puts the job here, the link thread moves it into the queue. A job stays
	  here while the LPWAN client uses SPI_A or LTE (up to CONFIG_SENSEI_GAP9_BUS_WAIT_S) or the
	  queue is full. gap9_link_submit() returns -ENOMEM when all slots are used.

config SENSEI_GAP9_RESULT_RING
	int "Results buffered for the delivery work queue (each costs one result struct of the app)"
	default 4
	range 2 16
	depends on SENSEI_GAP9
	help
	  A job may answer with many result frames (for example JPEG chunks). The link waits when the ring is full.

config SENSEI_GAP9_BOOT_TIMEOUT_MS
	int "Time from power-on to the GAP9 hello frame (ms)"
	default 4000
	depends on SENSEI_GAP9
	help
	  One retry with a power cycle follows before the queued jobs fail.

config SENSEI_GAP9_BUSFREE_TIMEOUT_MS
	int "Detect job: time from start to bus free (ms)"
	default 4000
	depends on SENSEI_GAP9
	help
	  The camera bus lock is released when this expires.

config SENSEI_GAP9_JOB_TIMEOUT_MS
	int "Time from job start (or bus free) to the result (ms)"
	default 8000
	depends on SENSEI_GAP9
	help
	  On expiry the job fails with -ETIMEDOUT and GAP9 is power cycled. The same time is given to
	  GAP9 to take a job that the link has armed (the job fails if it never does).

config SENSEI_GAP9_IDLE_OFF_MS
	int "Delay between the last job and the GAP9 power-off (ms)"
	default 200
	depends on SENSEI_GAP9

config SENSEI_GAP9_RESTART_OFF_MS
	int "Rail off time of a GAP9 power cycle (ms)"
	default 150
	depends on SENSEI_GAP9

config SENSEI_GAP9_BUS_WAIT_S
	int "Longest wait for SPI_A or an LTE transmission before a job is dropped (s)"
	default 90
	depends on SENSEI_GAP9
	help
	  GAP9 is not powered while the LPWAN client uses SPI_A or LTE is connecting or transmitting
	  (lib/sensei_busarb). Jobs wait; after this time they fail with -EBUSY.

config SENSEI_GAP9_REBOOT_GRACE_MS
	int "Time GAP9 stays on after the HELLO of gap9_link_reboot() (ms)"
	default 2000
	depends on SENSEI_GAP9
	help
	  A job submitted by the reboot callback in this time runs on the booted GAP9 without a new power cycle.

config SENSEI_GAP9_HOLD_MAX_S
	int "Longest gap9_link_hold() (s)"
	default 3600
	depends on SENSEI_GAP9
	help
	  The session owner releases the hold. This is the limit if it does not: the link releases it and GAP9
	  powers off after the idle time.

config SENSEI_GAP9_SHARED_GPIOS
	bool "Connect the shared GPIO lines (P0.28) while GAP9 is on"
	depends on SENSEI_GAP9
	help
	  Needed only for the GAP9 UART on P1.00 and P1.01 (the GAP9 link uses neither).

config SENSEI_GAP9_THREAD_STACK_SIZE
	int "GAP9 link thread stack (B)"
	default 4096
	depends on SENSEI_GAP9

config SENSEI_GAP9_SHELL
	bool "Shell commands: sensei gap9 [on|off|ping|status]"
	depends on SENSEI_GAP9 && SHELL
	help
	  Needs a shell root command "sensei" (SHELL_SUBCMD_SET_CREATE(<name>, (sensei)) in the app).

config SENSEI_GAP9_OTA
	bool "Update of the GAP9 application over the air (A/B slots in the GAP9 MRAM)"
	depends on SENSEI_GAP9
	select SETTINGS
	select SENSEI_CRYPTO
	select SENSEI_CRYPTO_ECDSA
	help
	  The nRF5340 side of the update: the session, the check of the image signature, the trial boot of the new
	  slot with the checks of the app, the revert, and the trial state in the settings (g9ota_flow.h,
	  gap9_ota_zephyr.h). GAP9 writes the slot with lib/sensei_gap9/src/g9ota.c. The app brings the public key,
	  the job format and its checks. Rules: lib/sensei_gap9/OTA.md.

	  The signature check is ECDSA P-256 under PSA: the app must size the mbed TLS heap (CONFIG_MBEDTLS_ENABLE_HEAP=y,
	  CONFIG_MBEDTLS_HEAP_SIZE=16384 or more) and have a work queue stack for it. The flow keeps one instance: one
	  update flow per app.

config SENSEI_GAP9_RECOVERY
	bool "Recovery of the GAP9 application over the air (the update writer in the GAP9 boot loader)"
	depends on SENSEI_GAP9_OTA
	help
	  Understands the HELLO of the GAP9 boot loader in recovery (no slot boots, GAP9/ssbl built with
	  SENSEI_SSBL_RECOVERY) and updates GAP9 through it: the app's jobs fail with -ENOEXEC while it runs
	  (GAP9 is not powered for them), the update flow writes the slot that the boot loader does not keep, checks
	  the signature, seals and starts it on trial. The recovery jobs are the SDK's (gap9_ota.proto): the app's job
	  struct must be at least as large as a recovery job (about 1.1 kB). Costs the recovery codec, one recovery job
	  of RAM and the checks of the flow. Untested on hardware. Rules: lib/sensei_gap9/OTA.md, "Recovery".

config SENSEI_GAP9_RECOVERY_REPROBE_H
	int "Time between two looks at a GAP9 that is in recovery (h)"
	default 6
	range 1 168
	depends on SENSEI_GAP9_RECOVERY
	help
	  GAP9 is in recovery after a failed update that left no bootable slot. The nRF5340 does not power it for
	  jobs of the app any more (they fail at once). It powers it once in this time to look whether the node was
	  repaired (JTAG, a recovery update by another host). Each look costs one power-up of GAP9 (a few hundred ms).

config SENSEI_GAP9_RECOVERY_STRAP
	bool "Recovery strap: P1.06 to GAP9 pad 57, to force recovery of a GAP9 that boots a bad image (UNVERIFIED hardware)"
	depends on SENSEI_GAP9_RECOVERY
	help
	  The update flow can power GAP9 with P1.06 (EXT_RX_SPI) high; the SSBL reads pad 57 with a pull-down and enters
	  recovery when it is high (Gap9OtaBegin.force_recovery). Needs P1.06 to be a free direct line to pad 57 with no
	  other driver. UNTESTED ON HARDWARE (TESTING.md T18.18): off by default. With it, P1.06 is an output that is low
	  whenever GAP9 is off (NRF/system/pwr).

config SENSEI_GAP9_THREAD_PRIORITY
	int "GAP9 link thread priority"
	default 4
	depends on SENSEI_GAP9
	help
	  Above the app work queue, so that the SPI turnaround stays short.

module = SENSEI_GAP9
module-str = SENSEI GAP9
source "subsys/logging/Kconfig.template.log_config"

endmenu
```

## lib/sensei_gas_index/zephyr/Kconfig
```kconfig
# SPDX-FileCopyrightText: 2026 ETH Zurich and University of Bologna
# SPDX-License-Identifier: Apache-2.0
#
# Authors:
# - Philip Wiese <wiesep@iis.ee.ethz.ch>

config SENSEI_GAS_INDEX
	bool "SENSEI gas index (Sensirion VOC and NOx index)"
	help
	  VOC and NOx index from SGP41 raw ticks (lib/sensei_gas_index). Floating point, needs the C math
	  library.
```

## lib/sensei_link/zephyr/Kconfig
```kconfig
# SPDX-FileCopyrightText: 2026 ETH Zurich and University of Bologna
# SPDX-License-Identifier: Apache-2.0
#
# Authors:
# - Philip Wiese <wiesep@iis.ee.ethz.ch>

config SENSEI_LINK
	bool "SENSEI link layer (framing and protobuf glue)"
	select NANOPB
	help
	  COBS and CRC-16 byte-stream framing, the SPI frame header, fragmentation, the nanopb helpers and
	  the SDK messages (lpwan.proto, types.proto). The generated sources are committed; the nanopb
	  runtime is the one of the NCS nanopb module (same commit as the SDK submodule, see README).

config SENSEI_SPI_MAX_PAYLOAD
	int "Largest payload of an SPI frame, bytes"
	depends on SENSEI_LINK
	default 8192
	range 1048 65535
	help
	  Longest message in one SPI frame (GAP9 jobs and results, LPWAN messages). Frames above it are
	  refused. Set the same value for every program that talks over the link.
```
