## CMakeLists.txt
```
# SPDX-FileCopyrightText: 2026 ETH Zurich and University of Bologna
# SPDX-License-Identifier: Apache-2.0
#
# Authors:
# - Philip Wiese <wiesep@iis.ee.ethz.ch>

cmake_minimum_required(VERSION 3.20.0)

find_package(Zephyr REQUIRED HINTS $ENV{ZEPHYR_BASE})
project(sensei_pwr_ram_test)

# CONFIG_SENSEI_PWR_RAM_POWERDOWN needs the nRF5340, so the test builds the source itself. The library call
# power_down_unused_ram() is a fake; _image_ram_end, the linker symbol of the end of the image RAM, is set from Kconfig.
target_sources(app PRIVATE src/main.c ${CMAKE_CURRENT_LIST_DIR}/../../system/pwr/pwr_ram.c)
target_include_directories(app PRIVATE ${CMAKE_CURRENT_LIST_DIR}/../../system)
zephyr_ld_options(-Wl,--defsym=_image_ram_end=${CONFIG_SENSEI_TEST_IMAGE_END})
```

## Kconfig
```
# SPDX-FileCopyrightText: 2026 ETH Zurich and University of Bologna
# SPDX-License-Identifier: Apache-2.0

config SENSEI_TEST_IMAGE_END
	hex "End of the image RAM (_image_ram_end)"
	default 0x20003210

source "Kconfig.zephyr"
```

## prj.conf
```kconfig
# SPDX-FileCopyrightText: 2026 ETH Zurich and University of Bologna
# SPDX-License-Identifier: Apache-2.0

CONFIG_ZTEST=y
```

## app.overlay
```dts
/*
 * SPDX-FileCopyrightText: 2026 ETH Zurich and University of Bologna
 * SPDX-License-Identifier: Apache-2.0
 */

/* RAM like the nRF5340 application core: 256 kB of zephyr,sram at 0x20000000 (the RAM of the chip is 512 kB, 8 banks of
 * 64 kB; the SENSEI boards keep the retained RAM and the shared memory above the chosen RAM). */
/ {
	test_sram: memory@20000000 {
		compatible = "mmio-sram";
		reg = <0x20000000 0x40000>;
	};

	chosen {
		zephyr,sram = &test_sram;
	};
};
```

## src/main.c
```c
/*
 * SPDX-FileCopyrightText: 2026 ETH Zurich and University of Bologna
 * SPDX-License-Identifier: Apache-2.0
 *
 * Authors:
 * - Philip Wiese <wiesep@iis.ee.ethz.ch>
 */

/* sensei_pwr_ram_powerdown() (NRF/system/pwr/pwr_ram.c): it calls the nRF Connect SDK library once and reports the
 * RAM it covers, the 4 kB sections from the end of the image RAM to the end of the chosen zephyr,sram (the library
 * knows no other region). The library is a fake here. The build-time checks of the file (every memory region lies
 * above zephyr,sram) pass for this devicetree; a board that breaks them does not build. */

#include <zephyr/fff.h>
#include <zephyr/ztest.h>

#include "pwr/pwr_ram.h"

DEFINE_FFF_GLOBALS;

FAKE_VOID_FUNC(power_down_unused_ram);

#define SRAM_END 0x20040000UL
#define SECTION 0x1000UL

ZTEST(pwr_ram, test_01_covered_ram) {
  size_t n = sensei_pwr_ram_powerdown();
  unsigned long image_end = CONFIG_SENSEI_TEST_IMAGE_END;
  unsigned long first = (image_end + SECTION - 1) / SECTION * SECTION; /* whole sections only */

  zassert_equal(power_down_unused_ram_fake.call_count, 1, "the library is called once");
  zassert_equal(n, first < SRAM_END ? SRAM_END - first : 0);
#if CONFIG_SENSEI_TEST_IMAGE_END == 0x20003210
  zassert_equal(n, 0x3c000, "from 0x20004000 to 0x20040000");
#else
  zassert_equal(n, 0, "no section left, and no wrap-around");
#endif
}

ZTEST_SUITE(pwr_ram, NULL, NULL, NULL, NULL, NULL);
```
