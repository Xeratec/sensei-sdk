## NRF/system/ota/Kconfig
```kconfig
# SPDX-FileCopyrightText: 2026 ETH Zurich and University of Bologna
# SPDX-License-Identifier: Apache-2.0
#
# Authors:
# - Philip Wiese <wiesep@iis.ee.ethz.ch>

menuconfig SENSEI_OTA
	bool "Firmware update with MCUboot: SMP server, trial boot and confirm"
	default n
	depends on SENSEI
	depends on BOOTLOADER_MCUBOOT
	select MCUMGR
	select MCUMGR_GRP_IMG
	select MCUMGR_GRP_OS
	select MCUMGR_GRP_OS_MCUMGR_PARAMS
	select IMG_MANAGER
	select FLASH
	select FLASH_MAP
	select STREAM_FLASH
	select STREAM_FLASH_ERASE
	select IMG_ERASE_PROGRESSIVELY
	select NET_BUF
	select ZCBOR
	select REBOOT
	select MCUMGR_MGMT_NOTIFICATION_HOOKS
	help
	  Helpers for apps that are started by MCUboot (see NRF/system/ota/README.md): the mcumgr image and
	  OS groups, the Bluetooth SMP transport, SMP on a shared byte stream (USB CDC), and the trial boot
	  supervision (confirm after a check, reset to revert otherwise). MCUboot comes from sysbuild
	  (SB_CONFIG_BOOTLOADER_MCUBOOT=y).

if SENSEI_OTA

config SENSEI_OTA_SMP_BT
	bool "SMP over Bluetooth (GATT SMP service)"
	default y if BT_PERIPHERAL
	depends on BT_PERIPHERAL
	select MCUMGR_TRANSPORT_BT
	help
	  Standard SMP service (UUID 8d53dc1d-1db7-4cd3-868b-8a527460aa84). The application sizes the net
	  buffers: MCUMGR_TRANSPORT_NETBUF_SIZE must hold an ATT MTU of 498 B (use 512). Access to the
	  service is the choice MCUMGR_TRANSPORT_BT_PERM_*: RW (open, for development), RW_ENCRYPT
	  (pairing required, needs BT_SMP) or RW_AUTHEN.

config SENSEI_OTA_SMP_STREAM
	bool "SMP on a byte stream shared with another protocol (USB CDC)"
	select BASE64
	select CRC
	select MCUMGR_TRANSPORT_SERIAL_HAS_SMP_OVER_CONSOLE
	help
	  mcumgr serial line framing (base64 lines) on a stream whose other frames are 0x00-delimited. See
	  sensei_smp_stream_feed() in sensei_ota.h.

config SENSEI_OTA_STREAM_MTU
	int "SMP MTU on the byte stream, bytes"
	default 256
	depends on SENSEI_OTA_SMP_STREAM
	help
	  Must not exceed MCUMGR_TRANSPORT_NETBUF_SIZE + 2.

config SENSEI_OTA_CONFIRM
	bool "Confirm the new image after the app's check passed"
	default y
	help
	  A new image runs on trial. If this is off, only an SMP confirm makes it permanent; without one it
	  reverts after SENSEI_OTA_TRIAL_TIMEOUT_S.

config SENSEI_OTA_CONFIRM_NEEDS_LINK
	bool "Confirm only after an SMP request came in on the new image"
	default y
	depends on SENSEI_OTA_CONFIRM
	select MCUMGR_SMP_COMMAND_STATUS_HOOKS
	help
	  A new image confirms itself only after an SMP request came in on it (BLE or USB: the update path
	  works). An image that passes the health check but can no longer be reached over SMP then stays on
	  trial and MCUboot reverts it. Apps with another update path can also call sensei_ota_link_seen().
	  The SMP request hook needs MCUMGR_SMP_COMMAND_STATUS_HOOKS (selected here, checked at build
	  time). Debug and Release builds can use the same setting.

config SENSEI_OTA_CONFIRM_DELAY_S
	int "Run time before the image is confirmed, s"
	default 30
	range 5 3600
	depends on SENSEI_OTA_CONFIRM

config SENSEI_OTA_TRIAL_TIMEOUT_S
	int "Trial time, s"
	default 300
	range 30 86400
	help
	  If the image is still unconfirmed after this time (it never passed the check, or nobody confirmed
	  it), the node resets and MCUboot goes back to the old image.

module = SENSEI_OTA
module-str = SENSEI OTA
source "subsys/logging/Kconfig.template.log_config"

endif # SENSEI_OTA
```

## NRF/system/pwr/Kconfig
```kconfig
# SPDX-FileCopyrightText: 2026 ETH Zurich and University of Bologna
# SPDX-License-Identifier: Apache-2.0
#
# Authors:
# - Philip Wiese <wiesep@iis.ee.ethz.ch>

if SENSEI_PWR

choice SENSEI_PWR_BATTERY
	prompt "Battery"
	default SENSEI_PWR_BATTERY_LISOCL2
	help
	  The battery of the board. One choice sets the charger, the charge table and the level thresholds,
	  so they cannot disagree.

config SENSEI_PWR_BATTERY_LISOCL2
	bool "Li-SOCl2 primary cell, 3.6 V (Saft LS33600, the SENSEI battery)"
	help
	  Not rechargeable: the charger of the MAX77654 is off (charging a primary cell is dangerous).
	  Charge table for a Li-SOCl2 cell. The input (USB) still powers the board.

config SENSEI_PWR_BATTERY_LIION
	bool "Li-ion or LiPo cell, 4.2 V"
	help
	  The charger is on with a constant voltage of 4.2 V and 15 mA (raise the current in
	  config/pmic_default.h for a larger cell). Charge table for a 4.2 V cell.

endchoice

config SENSEI_PWR_BAT_CRITICAL_MV
	int "Battery critical level (mV)"
	default 3100 if SENSEI_PWR_BATTERY_LIION
	default 2900

config SENSEI_PWR_BAT_LOW_MV
	int "Battery low level (mV)"
	default 3300 if SENSEI_PWR_BATTERY_LIION
	default 3100

config SENSEI_PWR_BAT_OK_MV
	int "Battery ok level (mV)"
	default 3500 if SENSEI_PWR_BATTERY_LIION
	default 3300

config SENSEI_PWR_CHARGE
	bool "Battery charge counter (lib/sensei_charge): coulomb counting in software"
	default n
	select SENSEI_CHARGE
	select SETTINGS
	# The retained RAM record (devicetree chosen sensei,charge, see README.md). Without it the record lives in noinit RAM.
	imply RETAINED_MEM
	imply RETENTION
	imply RETENTION_MUTEX_FORCE_DISABLE
	imply RETAINED_MEM_MUTEX_FORCE_DISABLE
	help
	  The MAX77654 has no fuel gauge. The application tells the module which states are on (GAP9 powered, BLE
	  connected, ...) and which events happened (a sensor reading, a LoRa uplink), the module counts the charge
	  with the table of the application, adds the idle floor and the self-discharge, and keeps the result in
	  retained RAM and in the settings. The power thread feeds it the battery voltage, the external power state,
	  the idle current (floor watchdog) and, with a Li-ion cell, the charge current and the charger-done reset.
	  See NRF/system/pwr/README.md and lib/sensei_charge/README.md.

if SENSEI_PWR_CHARGE

config SENSEI_PWR_CHARGE_DEFAULT_CAPACITY_MAH
	int "Capacity used while none is declared (mAh)"
	default 17000 if SENSEI_PWR_BATTERY_LISOCL2
	default 0
	help
	  17000 mAh is the Saft LS33600 of the SENSEI board. The Li-ion choice has no default (0): the counter reports the
	  used charge and learns the capacity from a full discharge. A default is flagged CAPACITY_DEFAULT.

config SENSEI_PWR_CHARGE_SAVE_H
	int "Hours between saves of the counter to the settings"
	default 6
	range 1 48
	help
	  A power loss (battery change) loses at most this long: the retained RAM does not survive it, the settings do. About
	  two flash entries per save, so a few erases per sector and year.

config SENSEI_PWR_CHARGE_FLOOR_MARGIN_UA
	int "Floor watchdog margin (uA)"
	default 2000
	help
	  An idle sample of the battery current that many uA above the board floor counts as high. Three in a row set
	  FLOOR_HIGH and the excess is counted. The sample is taken in the power thread, so the margin has to cover the CPU
	  being awake there (calibrate on the PPK2, TESTING.md).

config SENSEI_PWR_CHARGE_FAST_UA
	int "Fast-charge current of the charger (uA), Li-ion"
	default 15000
	help
	  The charge current monitor reports percent of the fast-charge current; this converts it (the 15 mA of
	  config/pmic_default.h).

endif # SENSEI_PWR_CHARGE

config SENSEI_PWR_BOOT_RAILS
	bool "Turn the PMIC rails on at boot, before the shield drivers start"
	default y if SHIELD_UT_SENSORSHIELD
	help
	  The chips of the sensor shield (PCA6416A expander, ISM330DHCX) are powered by the PMIC rails (3.3 V, 2.8 V,
	  1.2 V, LDO 3.3 V). Their drivers start at POST_KERNEL, long before main(), so the power module resets the
	  PMIC and switches the rails on in a SYS_INIT hook between the I2C bus and the expander. pwr_start() and the
	  application's board hook do not cycle the rails again. Without it the rails stay off until the board hook
	  turns them on.

endif # SENSEI_PWR

config SENSEI_PWR_CHECK
	bool "Device power state check (sensei_pwr_check_idle)"
	depends on SENSEI && PM_DEVICE
	help
	  Adds sensei_pwr_check_idle(), which lists the devices that are not suspended. For shell commands and
	  tests; it does not need the PMIC module (CONFIG_SENSEI_PWR).

config SENSEI_PWR_RAM_POWERDOWN
	bool "Power down RAM that the image does not use (nRF5340 application core)"
	depends on SENSEI && SOC_NRF5340_CPUAPP && !BUILD_WITH_TFM
	# newlib's malloc() grows the heap into all RAM after the image (sbrk)
	depends on !NEWLIB_LIBC
	# The libc arena (-1) is all RAM after the image: malloc() would use powered-down RAM
	depends on COMMON_LIBC_MALLOC_ARENA_SIZE != -1
	select RAM_POWER_DOWN_LIBRARY
	help
	  Adds sensei_pwr_ram_powerdown(), to be called at the end of the start-up. It powers down the 4 kB
	  sections between the end of the image RAM and the end of the chosen zephyr,sram (power_down_unused_ram() of
	  the nRF Connect SDK). Retained RAM, the other devicetree memory regions and the shared memory with the
	  network core lie above that range; the build checks it. Saves the retention current of those sections in
	  sleep (about 20 to 40 nA per section, estimate). Needs CONFIG_COMMON_LIBC_MALLOC_ARENA_SIZE other than -1
	  (set 0 when nothing calls malloc()) and not newlib.
	  A watchdog, lockup or pin reset does not power the RAM on again: the bootloader must do it
	  (SENSEI_PWR_RAM_ON_BOOT in MCUboot), else a smaller trial image that powered more RAM down leaves the image
	  it reverts to on RAM that is off.

config SENSEI_PWR_RAM_ON_BOOT
	bool "Power on all RAM at the start of the boot (MCUboot)"
	default y if MCUBOOT && SOC_NRF5340_CPUAPP
	depends on SOC_NRF5340_CPUAPP && !BUILD_WITH_TFM
	help
	  A PRE_KERNEL_1 hook powers on all 8 RAM blocks (VMC). Only a software reboot of the nRF Connect SDK does it
	  (NRF_FORCE_RAM_ON_REBOOT); after a watchdog, lockup or pin reset the sections that SENSEI_PWR_RAM_POWERDOWN
	  switched off stay off. MCUboot runs after every reset, so the hook there gives the next image all its RAM,
	  also when a trial image reverts to the old one. On by default in MCUboot (needs no SENSEI option); costs
	  about 100 B. The module is built without CONFIG_SENSEI.
```

## NRF/system/wdt/Kconfig
```kconfig
# Copyright (c) 2026 ETH Zurich and University of Bologna
# SPDX-License-Identifier: Apache-2.0

menuconfig SENSEI_WDT
	bool "Hardware watchdog"
	depends on SENSEI
	select WATCHDOG
	help
	  Hardware watchdog (devicetree alias watchdog0) that is fed only while the application reports
	  that it is healthy (sensei_wdt.h).

if SENSEI_WDT

config SENSEI_WDT_TIMEOUT_S
	int "Watchdog timeout (s)"
	default 60
	help
	  Timeout for applications that take it from Kconfig. Pass it to sensei_wdt_start().

config SENSEI_WDT_FEED_PERIOD_MS
	int "Feed period (ms)"
	default 5000
	help
	  Interval of the work item that feeds the watchdog. Keep it well below the timeout.

module = SENSEI_WDT
module-str = SENSEI watchdog
source "subsys/logging/Kconfig.template.log_config"

endif # SENSEI_WDT
```

## NRF/tests/bh1730/testcase.yaml
```yaml
# SPDX-FileCopyrightText: 2026 ETH Zurich and University of Bologna
# SPDX-License-Identifier: Apache-2.0
---
tests:
  sensei.drivers.bh1730:
    platform_allow:
      - native_sim/native/64
    tags: sensei drivers bh1730
```

## NRF/tests/crypto/testcase.yaml
```yaml
# SPDX-FileCopyrightText: 2026 ETH Zurich and University of Bologna
# SPDX-License-Identifier: Apache-2.0
---
tests:
  sensei.crypto:
    platform_allow:
      - native_sim/native/64
    tags: sensei crypto
```

## NRF/tests/diag/testcase.yaml
```yaml
# SPDX-FileCopyrightText: 2026 ETH Zurich and University of Bologna
# SPDX-License-Identifier: Apache-2.0
---
tests:
  sensei.diag:
    platform_allow:
      - native_sim/native/64
    tags: sensei diag
```

## NRF/tests/link/testcase.yaml
```yaml
# SPDX-FileCopyrightText: 2026 ETH Zurich and University of Bologna
# SPDX-License-Identifier: Apache-2.0
---
tests:
  sensei.link:
    platform_allow:
      - native_sim/native/64
    tags: sensei link
```
