## CMakeLists.txt
```
# SPDX-FileCopyrightText: 2026 ETH Zurich and University of Bologna
# SPDX-License-Identifier: Apache-2.0
#
# Authors:
# - Philip Wiese <wiesep@iis.ee.ethz.ch>

cmake_minimum_required(VERSION 3.20.0)

# The SDK system code needs the board devices i2ca and an ADC channel: emulators on native_sim.
list(APPEND EXTRA_DTC_OVERLAY_FILE ${CMAKE_CURRENT_LIST_DIR}/../common/sensei_sim.overlay)

find_package(Zephyr REQUIRED HINTS $ENV{ZEPHYR_BASE})
project(sensei_crypto_test)

# The known-answer tests are those of the example crypto_api (same file, no copy).
set(EXAMPLE_DIR ${CMAKE_CURRENT_LIST_DIR}/../../../example/crypto_api/src_NRF)
target_sources(app PRIVATE src/main.c)
target_include_directories(app PRIVATE ${EXAMPLE_DIR})
```

## prj.conf
```kconfig
# SPDX-FileCopyrightText: 2026 ETH Zurich and University of Bologna
# SPDX-License-Identifier: Apache-2.0

CONFIG_ZTEST=y
CONFIG_SENSEI=y
CONFIG_SENSEI_CRYPTO=y
CONFIG_MBEDTLS_ENABLE_HEAP=y
CONFIG_MBEDTLS_HEAP_SIZE=16384
CONFIG_MAIN_STACK_SIZE=16384
```

## src/main.c
```c
/*
 * SPDX-FileCopyrightText: 2026 ETH Zurich and University of Bologna
 * SPDX-License-Identifier: Apache-2.0
 *
 * Authors:
 * - Philip Wiese <wiesep@iis.ee.ethz.ch>
 */

/* SENSEI crypto library on PSA (Mbed TLS on native_sim). The checks are the known-answer tests of the example
 * crypto_api (NIST, RFC 4231, RFC 5869, RFC 6979, RFC 5903): the file is included, each group is one test case. */

#include <zephyr/ztest.h>

#include "../../../../example/crypto_api/src_NRF/tests.c"

static void *setup(void) {
  zassert_equal(sensei_crypto_init(), SENSEI_CRYPTO_OK);
  return NULL;
}

/* Runs one group and fails if one of its checks failed (the failing check is printed). */
static void run_group(void (*fn)(void)) {
  int before = n_failed;

  fn();
  zassert_equal(n_failed, before, "%d checks failed", n_failed - before);
}

ZTEST(sensei_crypto, test_random) { run_group(test_random); }
ZTEST(sensei_crypto, test_sha256) { run_group(test_sha256); }
ZTEST(sensei_crypto, test_hmac) { run_group(test_hmac); }
ZTEST(sensei_crypto, test_hkdf) { run_group(test_hkdf); }
ZTEST(sensei_crypto, test_aead_gcm) { run_group(test_aead); }
ZTEST(sensei_crypto, test_ecdsa_p256) { run_group(test_ecdsa); }
ZTEST(sensei_crypto, test_ecdh_p256) { run_group(test_ecdh); }
ZTEST(sensei_crypto, test_key_agreement_flow) { run_group(test_key_agreement_flow); }

ZTEST_SUITE(sensei_crypto, NULL, setup, NULL, NULL, NULL);
```
